## drivers/media/rc/Kconfig
```kconfig
menuconfig RC_CORE
	tristate "Remote Controller adapters"
	depends on INPUT
	default INPUT
	---help---
	  Enable support for Remote Controllers on Linux. This is
	  needed in order to support several video capture adapters.
	  Currently, all supported devices use InfraRed.

	  Enable this option if you have a video capture board even
	  if you don't need IR, as otherwise, you may not be able to
	  compile the driver for your adapter.

if RC_CORE

config LIRC
	tristate
	default y

	---help---
	   Enable this option to build the Linux Infrared Remote
	   Control (LIRC) core device interface driver. The LIRC
	   interface passes raw IR to and from userspace, where the
	   LIRC daemon handles protocol decoding for IR reception and
	   encoding for IR transmitting (aka "blasting").

source "drivers/media/rc/keymaps/Kconfig"

config IR_NEC_DECODER
	tristate "Enable IR raw decoder for the NEC protocol"
	depends on RC_CORE
	select BITREVERSE
	default y

	---help---
	   Enable this option if you have IR with NEC protocol, and
	   if the IR is decoded in software

config IR_RC5_DECODER
	tristate "Enable IR raw decoder for the RC-5 protocol"
	depends on RC_CORE
	select BITREVERSE
	default y

	---help---
	   Enable this option if you have IR with RC-5 protocol, and
	   if the IR is decoded in software

config IR_RC6_DECODER
	tristate "Enable IR raw decoder for the RC6 protocol"
	depends on RC_CORE
	select BITREVERSE
	default y

	---help---
	   Enable this option if you have an infrared remote control which
	   uses the RC6 protocol, and you need software decoding support.

config IR_JVC_DECODER
	tristate "Enable IR raw decoder for the JVC protocol"
	depends on RC_CORE
	select BITREVERSE
	default y

	---help---
	   Enable this option if you have an infrared remote control which
	   uses the JVC protocol, and you need software decoding support.

config IR_SONY_DECODER
	tristate "Enable IR raw decoder for the Sony protocol"
	depends on RC_CORE
	default y

	---help---
	   Enable this option if you have an infrared remote control which
	   uses the Sony protocol, and you need software decoding support.

config IR_RC5_SZ_DECODER
	tristate "Enable IR raw decoder for the RC-5 (streamzap) protocol"
	depends on RC_CORE
	select BITREVERSE
	default y

	---help---
	   Enable this option if you have IR with RC-5 (streamzap) protocol,
	   and if the IR is decoded in software. (The Streamzap PC Remote
	   uses an IR protocol that is almost standard RC-5, but not quite,
	   as it uses an additional bit).

config IR_MCE_KBD_DECODER
	tristate "Enable IR raw decoder for the MCE keyboard/mouse protocol"
	depends on RC_CORE
	select BITREVERSE
	default y

	---help---
	   Enable this option if you have a Microsoft Remote Keyboard for
	   Windows Media Center Edition, which you would like to use with
	   a raw IR receiver in your system.

config IR_LIRC_CODEC
	tristate "Enable IR to LIRC bridge"
	depends on RC_CORE
	depends on LIRC
	default y

	---help---
	   Enable this option to pass raw IR to and from userspace via
	   the LIRC interface.

config IR_ENE
	tristate "ENE eHome Receiver/Transceiver (pnp id: ENE0100/ENE02xxx)"
	depends on PNP
	depends on RC_CORE
	---help---
	   Say Y here to enable support for integrated infrared receiver
	   /transceiver made by ENE.

	   You can see if you have it by looking at lspnp output.
	   Output should include ENE0100 ENE0200 or something similar.

	   To compile this driver as a module, choose M here: the
	   module will be called ene_ir.

config IR_IMON
	tristate "SoundGraph iMON Receiver and Display"
	depends on USB_ARCH_HAS_HCD
	depends on RC_CORE
	select USB
	---help---
	   Say Y here if you want to use a SoundGraph iMON (aka Antec Veris)
	   IR Receiver and/or LCD/VFD/VGA display.

	   To compile this driver as a module, choose M here: the
	   module will be called imon.

config IR_MCEUSB
	tristate "Windows Media Center Ed. eHome Infrared Transceiver"
	depends on USB_ARCH_HAS_HCD
	depends on RC_CORE
	select USB
	---help---
	   Say Y here if you want to use a Windows Media Center Edition
	   eHome Infrared Transceiver.

	   To compile this driver as a module, choose M here: the
	   module will be called mceusb.

config IR_ITE_CIR
	tristate "ITE Tech Inc. IT8712/IT8512 Consumer Infrared Transceiver"
	depends on PNP
	depends on RC_CORE
	---help---
	   Say Y here to enable support for integrated infrared receivers
	   /transceivers made by ITE Tech Inc. These are found in
	   several ASUS devices, like the ASUS Digimatrix or the ASUS
	   EEEBox 1501U.

	   To compile this driver as a module, choose M here: the
	   module will be called ite-cir.

config IR_FINTEK
	tristate "Fintek Consumer Infrared Transceiver"
	depends on PNP
	depends on RC_CORE
	---help---
	   Say Y here to enable support for integrated infrared receiver
	   /transciever made by Fintek. This chip is found on assorted
	   Jetway motherboards (and of course, possibly others).

	   To compile this driver as a module, choose M here: the
	   module will be called fintek-cir.

config IR_NUVOTON
	tristate "Nuvoton w836x7hg Consumer Infrared Transceiver"
	depends on PNP
	depends on RC_CORE
	---help---
	   Say Y here to enable support for integrated infrared receiver
	   /transciever made by Nuvoton (formerly Winbond). This chip is
	   found in the ASRock ION 330HT, as well as assorted Intel
	   DP55-series motherboards (and of course, possibly others).

	   To compile this driver as a module, choose M here: the
	   module will be called nuvoton-cir.

config IR_REDRAT3
	tristate "RedRat3 IR Transceiver"
	depends on USB_ARCH_HAS_HCD
	depends on RC_CORE
	select USB
	---help---
	   Say Y here if you want to use a RedRat3 Infrared Transceiver.

	   To compile this driver as a module, choose M here: the
	   module will be called redrat3.

config IR_STREAMZAP
	tristate "Streamzap PC Remote IR Receiver"
	depends on USB_ARCH_HAS_HCD
	depends on RC_CORE
	select USB
	---help---
	   Say Y here if you want to use a Streamzap PC Remote
	   Infrared Receiver.

	   To compile this driver as a module, choose M here: the
	   module will be called streamzap.

config IR_WINBOND_CIR
	tristate "Winbond IR remote control"
	depends on X86 && PNP
	depends on RC_CORE
	select NEW_LEDS
	select LEDS_CLASS
	select LEDS_TRIGGERS
	select BITREVERSE
	---help---
	   Say Y here if you want to use the IR remote functionality found
	   in some Winbond SuperI/O chips. Currently only the WPCD376I
	   chip is supported (included in some Intel Media series
	   motherboards).

	   To compile this driver as a module, choose M here: the module will
	   be called winbond_cir.

config RC_LOOPBACK
	tristate "Remote Control Loopback Driver"
	depends on RC_CORE
	---help---
	   Say Y here if you want support for the remote control loopback
	   driver which allows TX data to be sent back as RX data.
	   This is mostly useful for debugging purposes.

	   If you're not sure, select N here.

	   To compile this driver as a module, choose M here: the module will
	   be called rc_loopback.

config LIRC_STM
                tristate "STM Driver"
                depends on LIRC && STM_DRIVERS
		help
		 The IR and UHF RX processors are identical and independent,
		 except that the IR receiver does not use the noise and
		 SCD filters. Not all ST platforms support both type of
		 receivers.
		 IR RX receiver is the default mode.

		config LIRC_STM_UHF
			bool "UHF RX receiver processor"
			depends on LIRC_STM
			help
			  Set this option to enable UHF instead of IR remote control input.

			  Note this option has no direct effect in the LiRC driver. It is used by
			  some boards which have support for both UHF and IR support to set the
			  configuration parameters passed into the driver. Not all boards have
			  support for both modes of operation, so this option may have no effect,
			  and hardware changes (such as changing jumpers) may be required.

	        config LIRC_STM_UHF_SCD
		        bool "Start Code Detector - SCD"
			depends on LIRC_STM_UHF
			default n
			help
			  This causes the driver to use SCD on UHF RX mode.
			  The start code detector detects any programmable start
			  code on UHF RX input. It works on a time unit called
			  symbol time. One graphical example to understand how to
			  configure properly the code, code length and nominal time
			  values based on Remote Control signals train can be found in
			  drivers/media/rc/lirc_ir.c driver.

	        config LIRC_STM_UHF_SCD_CODE
			hex "Normal code to be detected"
			default "0x3FFFC028"
			depends on LIRC_STM_UHF_SCD
			help
			 The primary RC to be detected.
			 Default value for Futarque RC is 0x3FFFC028.

	        config LIRC_STM_UHF_SCD_ALTCODE
			hex "Alternative code to be detected"
			default "0x0"
			depends on LIRC_STM_UHF_SCD
			help
			 The second RC to be detected as alternative of the primary.
			 The primary must be always setup before the use this.

	        config LIRC_STM_UHF_SCD_NTIME
			hex "Nominal time for a symbol"
				default "0x1f4"
			depends on LIRC_STM_UHF_SCD
			help
			 Default value for Futarque RC is 0x1f4. The nominal time
			 is the same for normal and alternative symbols calculation.

		config LIRC_STM_TX
			depends on LIRC_STM
			bool "IRB TX transmitter processor"
			default n
			help
			 Say yes if you want enable IR transmission. The IR TX processor is
			 independent of IR RX mode.

	config LIRC_STM_DEBUG
		depends on LIRC_STM
		bool "Driver debug"
		default n
		help
		  Say yes if you want enable some debug printk information

endif #RC_CORE
```

## drivers/net/ethernet/stmicro/isve/Kconfig
```kconfig
config STM_ISVE
	tristate "Integrated SoC Virtual Ethernet driver (EXPERIMENTAL)"
	depends on HAS_IOMEM && ARCH_STM && EXPERIMENTAL
	select NET_CORE
	select CRC32
	---help---
	  This is the virtual Ethernet driver used in the new ST SoC
	  generations.
	  It dials with a special HW bridge designed to allow the communication
	  among DOCSIS system CPUs.
	  This means that all devices connected through a sort of virtual
	  Ethernet devices.

	  Say N to exclude this support.

if STM_ISVE

config ISVE_DEBUG
	bool "Enable ISVE internal debugging option"
	depends on STM_ISVE
	default n

endif
```

## drivers/net/ethernet/stmicro/stmfp/Kconfig
```kconfig
#
# STMFP network device configuration
#

config STM_FASTPATH
	tristate "STM FastPath Driver"
	select NET_CORE
	select MII
	select PHYLIB
	select FIXED_PHY
	select STMMAC_ETH
	---help---
	  Driver for STM FastPath Ethernet device. This hardware is used
	  on some STM embedded platforms to route packets from multiple on
	  chip devices to external Ethernet ports. This driver implements a
	  simple Ethernet interface on each of the hardware ports.
	  If you have a controller with this interface, say Y or M here.
	  If unsure, say N.

config FP_FPGA
	tristate "STM FastPath for FPGA Platform(EXPERIMENTAL)"
	depends on PCI && EXPERIMENTAL && STM_FASTPATH
	default n
	---help---
	  Support for STM FastPath FPGA Platform.
	  If you have a FPGA platform with this interface, say Y or M here.
	  If unsure, say N.
```
