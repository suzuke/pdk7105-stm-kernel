## drivers/stm/Kconfig
```kconfig
#
# STM specific device configuration
#

config STM_DRIVERS
	def_bool n
	select ARCH_REQUIRE_GPIOLIB

menu "STM specific devices"
        depends on STM_DRIVERS

config STM_PCI_EMISS
	bool "STMicroelectronics PCI controller"
	depends on PCI && (CPU_SUBTYPE_STX7108)
	def_bool n
	---help---
	  This option adds support for the PCI controller found on some
	  STMicroelectronics SOCs.

# PCIe controller from synopsys, wrapped for HVD parts
config STM_PCIE
	bool "STMicroelectronics PCI express controller"
	depends on PCI && (CPU_SUBTYPE_STX7108 || CPU_SUBTYPE_STXH205 || \
		ARCH_STM)
	def_bool n
	select ARCH_SUPPORTS_MSI
	---help---
	  This option adds support for the PCI express controller found on some
	  STMicroelectronics SOCs.

config STM_MIPHY
	def_bool y

config STM_MIPHY_TAP
	bool
	depends on STM_MIPHY
	default y if CPU_SUBTYPE_STX7108
	default y if CPU_SUBTYPE_STIH415
	default n

config STM_MIPHY_PCIE_MP
	bool
	depends on STM_MIPHY
	default y if CPU_SUBTYPE_STX7108
	default y if MACH_STM_STID127
	default y if MACH_STM_STIG125
	default y if CPU_SUBTYPE_STXH205
	default y if CPU_SUBTYPE_STIH415
	default y if MACH_STM_STIH416
	default n

config STM_MIPHY_DUMMY
	bool
	depends on STM_MIPHY
	default n

config STM_MIPHY365X
	bool
	depends on STM_MIPHY
	default y if CPU_SUBTYPE_STX7108
	default y if CPU_SUBTYPE_STIH415
	default y if MACH_STM_STIH416
	default n

config STM_MIPHYA40X
	bool
	depends on STM_MIPHY
	default y if MACH_STM_STID127
	default y if MACH_STM_STIG125
	default y if CPU_SUBTYPE_STXH205
	default n

config STPIO
	bool "Legacy stpio API"
	default n
	help
	  Select this option to enable the legacy stpio interface. No
	  code within the kernel uses this API, it is retained only for
	  drivers outside the kernel which might still need it.

config STM_COPROCESSOR_CLASS
	tristate "STMicroelectronics coprocessor support"
	select FW_LOADER
	select BPA2
	select LIBELF_32
	---help---
	  Many of the ST system-on-chip devices have multiple CPUs, where a
	  master CPU running Linux has control over a number of slave CPUs,
	  which are usually used to run dedicated algorithms.
	  Enabling this option will add support to the Linux kernel to
	  control these slave CPUs, reserve memory for them, and thus allow
	  code to be downloaded onto them and executed.

	  Memory allocation is managed through BPA2 so, to define a
	  coprocessor's memory size and address, use the normal BPA2
	  command line option:
	    bpa2_parts=<name0>:<size0>:<address0>,<name1>:<size1>:<address1>,...
	  where:
	    <nameX> is "coproc_" followed by the coprocessor name, for example
	    "audio0".
	    <sizeX> defines the size of the partition
	    <addressX> defines the base address of memory reserved for the
	    coprocessor application code and data.

	  For example:
	    bpa2_parts=coproc_video0:16m:0x06000000,coproc_audio0:16m:0x07000000

	  As with all other BPA2 addresses, addresses are physical addresses,
	  and so may appear at different virtual addresses when mapped into the
	  CPU's memory map.

config STM_COPROCESSOR_ST40
	tristate "ST40 coprocessor support"
	depends on STM_COPROCESSOR_CLASS
	---help---
	  Provide support for ST40 coprocessor hardware.

config STM_COPROCESSOR_ST200
	tristate "ST200 coprocessor support"
	depends on STM_COPROCESSOR_CLASS
	---help---
	  Provide support for ST200 coprocessor hardware.

config  COPROCESSOR_DEBUG
        depends on STM_COPROCESSOR_CLASS
        bool "STM coprocessor debug"
        default n
        ---help---
          Enable this option to print out information about the slave CPUs
          addresses and operations you are using for coprocessor.

config STM_RNG
       bool "STM Random Number Generator Support"
       default y
       ---help---
         This option adds support for the hardware Random Number Generator
         (RNG) present on different STMicroelectronics SoCs.  It allows the
         RNG to feed /dev/random with entropy thereby ensuring real
         random numbers from this device.

         Without this option, /dev/random has little entropy and is not
         useful.  In fact, it may block for a long time while waiting for
         entropy.

         This option should always be enabled for relevant SoCs.

         This option can be used in conjunction with the /dev/hw_random
         driver found in the char drivers menu.

config STM_HAS_MALI
	def_bool n

config STM_MALI
	depends on STM_HAS_MALI
	tristate "STM Mali GPU support"
	default n
	select STM_MALI_MEM_SHARED
	---help---
	  Enable this option to support Mali GPU Driver.

menu "Mali memory model"
	depends on STM_MALI
	comment "Configurable Mali memory models"

config  STM_MALI_MEM_SHARED
        bool "Mali memory model: shared"
	default y
	---help---
	  This resource configures the driver to obtain graphics
	  memory from OS.
	  This has the advantage that there is no requirement for memory to be
	  specifically reserved for the Mali GPU.
	  This is always enabled to have Mali GPU working fine with at least
	  the OS memory usage.

config STM_MALI_MEM_SIZE
	hex "Mali memory size"
	depends on STM_MALI_MEM_SHARED
	default "0x0E000000"
	---help---
	  Specify the size of memory which the Mali driver is allowed to
	  allocate from Linux kernel.
	  If you choice the shared memory model this size value rappresents the
	  maximum limit of memory the OS can assign to the Mali GPU.

config	STM_MALI_MEM_DEDICATED
	bool "Mali memory model: dedicated"
	default n
	select BPA2
	---help---
	  Use this resource to configure dedicated areas of memory that are used
	  exclusively by the Mali GPU. You must not share this memory with
	  any other device or memory allocator.
	  The memory allocator privileges this than the shared.
	  Only when the dedicated memory will finish the allocator will use
	  the shared.

	  The driver will retreive base address and size from a BPA2 partition
	  called: mali-memory:base:size

	  bpa2parts=mali-memory:192M:0x40000000

	  If unsure don't use this but the shared memory model.
endmenu
	  
config STM_MALI_DEBUG
	depends on STM_MALI
	bool "Enable Mali debug tracing"
	default y
	---help---
	  Enable this option to enable debug trace messages on the console

config STM_MALI_PROFILING
	depends on STM_MALI
	bool "Mali profiling"
	select TRACEPOINTS
	default n
	---help---
	  This enables gator profiling of Mali GPU events.

config STM_MALI_INTERNAL_PROFILING
	bool "Enable internal Mali profiling API"
	depends on STM_MALI_PROFILING
	default n
	---help---
	  This enables the internal legacy Mali profiling API.

config STM_SYSTRACE
	bool "System Trace Module"
        depends on (STM_DRIVERS && (MACH_STM_STIH416||MACH_STM_STIH415))
	select MTT
	default m
	---help---
	  The System Trace Module peripheral complies with MIPI-Alliance
	  specifications for the System Trace Protocol(STP) v2.
	  See http://www.mipi.org/specifications/debug and in Documentation
	  systrace.txt and mtt.txt.
	  The trace data is built and written through the MTT Trace facility
	  (see mtt-systrace.txt), and output on the MIPI wires.

config STM_AMBA_BRIDGE
	bool
        depends on STM_DRIVERS
	default y

config STM_IRQ_MUX
	depends on STM_DRIVERS
	bool "STM IRQ-Mux support"
	default n
	---help---
	  Enable this option to support IRQ-MUX mapping in the kernel.

config STM_DOCSIS_QUEUE
	depends on (STM_DRIVERS && OF && (MACH_STM_STID127 || MACH_STM_STIG125))
	tristate "DOCSIS Downstream/Upstream Module"
	default n
	---help---
	  Enable this option to program some Downstream/Upstream registers
	  before using ISVE driver.

config STM_LPM
	bool "STM Low Power Monitor"
	depends on CPU_SUBTYPE_STXH205
	select LIBELF_64
	default n
	help
	 Enable this option for Standby Controller support.

config STM_LPM_DEBUG
	bool "STM Low Power Monitor debug"
	depends on STM_LPM
	default n
	help
	 Enable this option to print debug information.

endmenu
```

## kernel/mtt/Kconfig
```kconfig
config MTT
	bool "Multi-Target Trace (MTT) infrastructure support"
	select KPROBES
	select DEBUG_FS
	select RELAY
	select SYSFS
	select KALLSYMS
	default y
	help
	  MTT provides a trace infrastructure with an API and binary
	  data format common to ARM/ST40/ST2xx/XP70. It also provides
	  support for kptraceV4. ST kernel code may use this API
	  (mtt_trace, mtt_print) for critical trace data, or when
	  postprocessing is wanted. See "Documentation/mtt.txt"
	  MTT is also the interface for the System Trace Module IP.
```

## sound/stm/Kconfig
```kconfig
menuconfig SND_STM
	tristate "STMicroelectronics SoCs support"
	depends on SND
	depends on STM_DRIVERS
	select SND_PCM
	select DMADEVICES
	select STM_FDMA
	help
		Say Y here for ALSA support on the STMicroelectronics SoCs.

		This driver provides core functionality - you have to build
		(at least one) SoC-specific driver as well. Additionally, it is
		using dynamic device minor number allocation, so udev-like
		utility is required.

		It is recommended to have BPA2 enabled with dedicated
		partition defined, however it is not absolutely necessary.

		To compile this driver as a module, choose M here: the module
	 	will be called snd-stm.ko

config SND_STM_PCM_PLAYER
	tristate
	depends on SND_STM
	default n

config SND_STM_PCM_READER
	tristate
	depends on SND_STM
	default n

config SND_STM_SPDIF_PLAYER
	tristate
	depends on SND_STM
	default n

config SND_STM_UNIPERIF_PLAYER
	tristate
	depends on SND_STM
	select STM_FDMA_AUDIO
	default n

config SND_STM_UNIPERIF_READER
	tristate
	depends on SND_STM
	default n

config SND_STM_CONV_BIPHASE
	tristate
	depends on SND_STM
	default n

config SND_STM_CONV_DAC_MEMORY_MAPPED
	tristate
	depends on SND_STM
	default n

config SND_STM_CONV_DAC_SYSCONF
	tristate
	depends on SND_STM
	default n

config SND_STM_CONV_I2S_TO_SPDIF
	tristate
	depends on SND_STM
	default n

config SND_STM_CONV_SPDIF_RX
	tristate
	depends on SND_STM
	default n

config SND_STM_BPA2_PARTITION_NAME
	string "Name of BPA2 partition to allocate buffers from"
	depends on SND_STM
	depends on BPA2
	default "audio"
	help
		Define a name of BPA2 partition the driver should try to
		allocate from.

		If name is not given or given partition does not exist, driver
		will try to use "bigphysmem" partition or eventually
		preallocate some system memory using
		ALSA snd_pcm_lib_preallocate_pages_for_all() method.

		This value can be overridden by module parameter
		"bpa2_part=<name>" (or kernel command line parameter
		"snd-stm.bpa2_part=<name>", if driver is compiled into
		kernel).

comment "SOC support"
	depends on SND_STM

config SND_STM_FLI7610
	tristate "FLi7610 support"
	depends on SND_STM
	default y if CPU_SUBTYPE_FLI7610
	select SND_STM_UNIPERIF_PLAYER
	select SND_STM_UNIPERIF_READER
	select SND_STM_CONV_BIPHASE
	select SND_STM_CONV_DUMMY
	select SND_STM_CONV_GPIO
	select SND_STM_CONV_SPDIF_RX
	help
		Select this to get ALSA driver for FLi7610 chip.

		If you compile this driver as a module, it will be
		called snd-stm-stih415.ko

config SND_STM_STX7108
	tristate "STx7108 support"
	depends on SND_STM
	default y if CPU_SUBTYPE_STX7108
	select SND_STM_PCM_PLAYER
	select SND_STM_PCM_READER
	select SND_STM_SPDIF_PLAYER
	select SND_STM_CONV_DAC_SYSCONF
	select SND_STM_CONV_I2S_TO_SPDIF
	help
		Select this to get ALSA driver for STx7108 chip.

		If you compile this driver as a module, it will be
		called snd-stm-stx7108.ko

config SND_STM_STIG125
	tristate "STiG125 support"
	depends on SND_STM
	default y if CPU_SUBTYPE_STIG125
	select SND_STM_UNIPERIF_PLAYER
	select SND_STM_UNIPERIF_READER
	select SND_STM_CONV_BIPHASE
	select SND_STM_CONV_DAC_SYSCONF
	help
		Select this to get ALSA driver for STiG125 chip.

		If you compile this driver as a module, it will be
		called snd-stm-stig125.ko

config SND_STM_STIH415
	tristate "STih415 support"
	depends on SND_STM
	default y if CPU_SUBTYPE_STIH415
	select SND_STM_UNIPERIF_PLAYER
	select SND_STM_UNIPERIF_READER
	select SND_STM_CONV_BIPHASE
	select SND_STM_CONV_DAC_SYSCONF
	help
		Select this to get ALSA driver for STih415 chip.

		If you compile this driver as a module, it will be
		called snd-stm-stih415.ko

config SND_STM_STIH416
	tristate "STiH416 support"
	depends on SND_STM
	default y if MACH_STM_STIH416
	select SND_STM_UNIPERIF_PLAYER
	select SND_STM_UNIPERIF_READER
	select SND_STM_CONV_BIPHASE
	select SND_STM_CONV_DAC_SYSCONF
	help
		Select this to get ALSA driver for STiH416 chip.

		If you compile this driver as a module, it will be
		called snd-stm-stih416.ko

comment "External converters"
	depends on SND_STM

config SND_STM_CONV_DUMMY
	tristate "Dummy converter driver"
	depends on SND_STM
	help
		This provides dummy converter driver to configure
		digital audio interface format (I2S, Left-Justified,
		Right-Justified). See include/sound/stm.h for
		more information.

		If compiled as module, it will be called
		snd-stm-conv-dummy.ko.

config SND_STM_CONV_EPLD
	tristate "Generic EPLD-controlled converter driver"
	depends on SND_STM
	depends on SH_ST_EPLD
	help
		This provides generic driver for EPLD-controlled
		converters. See include/sound/stm.h for informations
		how to define EPLD offsets & values.

		If compiled as module, it will be called
		snd-stm-conv-epld.ko.

config SND_STM_CONV_GPIO
	tristate "Generic GPIO-controlled converter driver"
	depends on SND_STM
	help
		This provides generic driver for GPIO-controlled
		converters. See include/sound/stm.h for informations
		how to define GPIO line numbers.

		If compiled as module, it will be called
		snd-stm-conv-gpio.ko.

config SND_STM_CONV_I2C
	tristate "Generic I2C-controlled converter driver"
	depends on SND_STM && I2C
	help
		This provides generic driver for I2C-controlled
		converters. See include/sound/stm.h for informations
		how to define required I2C addresses & commands.

		If compiled as module, it will be called
		snd-stm-conv-i2c.ko.
```
