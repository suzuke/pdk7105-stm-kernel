## Documentation/devicetree/bindings/stm/sysconf.txt
```
*******************************************************************************
			Sysconf
*******************************************************************************
Each sysconf bank is represented in soc device trees at two places.
First on to define the sysconf itself.
		sysconf@febf0000{
			compatible= "st,sysconf", "simple-bus";
			reg = <0xfebf0000 0xe4>;
			group@0 {
				group = <0>;
				offset = <0>;
				start	= <0>;
				group-name = "SYSCFG_WEST";
			};
		};

Required properties:

- compatible : should be "st,sysconf".
- reg, reg-names, interrupts, interrupt-names	: Standard way to define device
			resources with names. look in
			Documentation/devicetree/bindings/resource-names.txt
- group		: Should be sysconf group number.
- offset	: Should be the offset in the current sysconf.
- start		: Should be the start sysconf number in the current bank.
- group-name	: Should be name of the sysconf, will be used in debugfs.


Second entry adds a reverse lookup table, this node is used as phandle when
refering to a sysconf.

	sysconf: sysconf{
		#sysconf-group-cells	= <3>;
		sysconf-groups = <0    56 0>,
				 <200 283 1>,
				 <400 430 2>,
				 <705 769 3>,
				 <800 813 4>,
				 <900 944 5>;

		sysconf-names  = "SYSCFG_WEST",
				 "SYSCFG_SOUTH",
				 "SYSCFG_NORTH",
				 "SYSCFG_CPU",
				 "SYSCFG_DDR",
				 "SYSCFG_HD";
	};

Typical usage example:
in pio-control:

		pio-control@0 {
			alt-control = <&sysconf 0 0 31>;
			oe-control = <&sysconf 10 0 7>;
			pu-control = <&sysconf 13 0 7>;
			od-control = <&sysconf 16 0 7>;
			retime-style = "none";

		};
or in device config

		sata1_dev_config: sata_dev_config-0 {
			#stm-sysconf-cells = <4>;
			device-seqs = <&sata1_dev_seqs>;
			sysconfs{
				SATA_SELECT	= <&sysconf 267 9 9>;
				SATA_USE_30MHZ	= <&sysconf 268 0 0>;
				AHCI_HOST_PWR =	<&sysconf 267 8 8>;
				AHCI_HOST_PWR_ACK = <&sysconf 281 5 5>;
			};
		};

Usage is verymuch inline with the old style.
```

## Documentation/devicetree/bindings/tty/serial/stm-asc.txt
```
===============================================================================
			stm asc(Serial Port)
===============================================================================

Required properties:
- compatible : "st,asc".
- reg, reg-names, interrupts, interrupt-names	: Standard way to define device
			resources with names. look in
			Documentation/devicetree/bindings/resource-names.txt
- st,hw-flow-ctrl	This is a condition node for some of the pads to allow
			hw-flow control.
- pad-config	is the standard way to pass pad config to the drivers.


Optional properties:
- st,force-m1		force asc to be in Mode-1 recommeded for high
			bit rates (above 19.2K)
- st,txfifo-bug	workaround to know bug.
- st,clk-id		clk name to be used by the stm-asc driver instance.

Example:

asc0: stm-asc0 {
    #interrupt-cells = <3>;
    #address-cells = <1>;
    #size-cells = <1>;
    interrupt-parent = <&intc>;
    compatible    = "st,asc", "simple-bus";
    reg         = <0xfe440000 0x2c>;
    interrupts     =  <0 209 0>;
    pad-config = <&asc0_pad_config>;

    st,txfifo-bug;
    st,force-m1;
    st,clk-id     = "sbc_comms_clk";
    hw_flowctrl: st,hw-flow-ctrl {
        enable    = <0>;
    };
    asc0_pad_config: asc0-pad-config {
        #gpio-cells = <1>;
        #stm-pad-cells = <6>;
        gpios{
            TX  = <&gpio_bank3 4 &dir_out &altfun_1 >;
            RX  = <&gpio_bank3 5 &dir_in &altfun_1 >;
            CTS = <&gpio_bank3 6 &dir_in &altfun_1 &hw_flowctrl>;
            RTS = <&gpio_bank3 7 &dir_out &altfun_1 &hw_flowctrl>;
        };
    };
};
```

## Documentation/devicetree/bindings/usb/stm-usb.txt
```
===============================================================================
				stm usb
===============================================================================

Required properties:
- compatible : "st,usb".
- reg, reg-names, interrupts, interrupt-names	: Standard way to define device
			resources with names. look in
			Documentation/devicetree/bindings/resource-names.txt
			hcd driver expects these  resources to be named as follows
			"wrapper", "ohci", "ehci", "protocol".

- strap-8bit	Strap mode 8 Bit.
- strap-16bit	Strap mode 16 Bit.
- strap-pll		Start Strap PLL.
- device-config	phandle to device config.
- amba-config	phandle to ST-AMBA Bridge settings.


Example:
		stm_usb0: usb-0{
			compatible	= "st,usb", "simple-bus";
			status = "disabled";
			amba-config		= <&usb_amba_config>;
			strap-8bit;
			reg		=	<0xfe100000 0x100>,
						<0xfe1ffc00 0x100>,
						<0xfe1ffe00 0x100>,
						<0xfe1fff00 0x100>;
			reg-names = "wrapper", "ohci", "ehci", "protocol";

			interrupts	=  <0 155 0>, <0 156 0>;
			interrupt-names = "ehci","ohci";
			device-config = <&usb0_dev_config>;
			usb0_dev_config: usb_dev_config-0 {
				#stm-sysconf-cells = <4>;
				padcfg-0 = <&padcfg_usb0>;
				device-seqs = <&usb_dev_seqs>;
				sysconfs{
					USB_HOST_PWR = <&stih415_sysconf 336 0 0>;
					USB_PWR_ACK = <&stih415_sysconf 384 0 0>;
					USB_IN_DC_SHIFT = <&stih415_sysconf 332 0 0>;
					USB_IN_EDGE_CTRL = <&stih415_sysconf 332 3 3>;
				};
			};

		};
		usb_dev_seqs: usb-dev-seqs{
			init-seq{
				step0 {
					USB_IN_DC_SHIFT = <0>;
					type = "sysconf";
				};
				step1 {
					USB_IN_EDGE_CTRL = <1>;
					type = "sysconf";
				};
			};
			power-on-seq{
				step0 {
					USB_HOST_PWR = <0>;
					type = "sysconf";
				};
				step1{
					USB_PWR_ACK = <0>;
					type = "sysconf-feedback";
				};
			};
			power-off-seq{
				step0 {
					USB_HOST_PWR = <1>;
					type = "sysconf";
				};
				step1{
					USB_PWR_ACK = <1>;
					type = "sysconf-feedback";
				};
			};
		};

		usb_amba_config: usbambaconfig {
			bridge_type2;
			sd_config_missing;
			complete_on_error;
			read_ahead;
			max_opcode_LD32_ST32;

			chunks_in_msg	=	<0>;
			packets_in_chunk	=	<8>;
			threshold		=	<128>;
		};
```

## arch/arm/configs/b2110_defconfig
```kconfig
CONFIG_EXPERIMENTAL=y
CONFIG_LOCALVERSION="-b2110"
# CONFIG_LOCALVERSION_AUTO is not set
CONFIG_SYSVIPC=y
CONFIG_BSD_PROCESS_ACCT=y
CONFIG_IKCONFIG=y
CONFIG_IKCONFIG_PROC=y
CONFIG_CGROUPS=y
CONFIG_CGROUP_FREEZER=y
CONFIG_CGROUP_DEVICE=y
CONFIG_CPUSETS=y
CONFIG_CGROUP_CPUACCT=y
CONFIG_RESOURCE_COUNTERS=y
CONFIG_CGROUP_MEM_RES_CTLR=y
CONFIG_CGROUP_MEM_RES_CTLR_SWAP=y
CONFIG_NAMESPACES=y
CONFIG_CC_OPTIMIZE_FOR_SIZE=y
CONFIG_SYSCTL_SYSCALL=y
CONFIG_KALLSYMS_ALL=y
CONFIG_EMBEDDED=y
# CONFIG_COMPAT_BRK is not set
CONFIG_MODULES=y
CONFIG_MODULE_UNLOAD=y
CONFIG_MODULE_SRCVERSION_ALL=y
CONFIG_BLK_DEV_INTEGRITY=y
CONFIG_ARCH_STM=y
CONFIG_MACH_STM_STID127_BOARD=y
# CONFIG_ARM_THUMB is not set
# CONFIG_SWP_EMULATE is not set
CONFIG_PL310_ERRATA_588369=y
CONFIG_PL310_ERRATA_727915=y
CONFIG_ARM_ERRATA_743622=y
CONFIG_ARM_ERRATA_754322=y
CONFIG_PCI=y
CONFIG_SMP=y
CONFIG_PREEMPT=y
CONFIG_AEABI=y
CONFIG_KSM=y
CONFIG_USE_OF=y
CONFIG_VFP=y
# CONFIG_CORE_DUMP_DEFAULT_ELF_HEADERS is not set
CONFIG_HIBERNATION_ON_MEMORY=y
CONFIG_PM_RUNTIME=y
CONFIG_NET=y
CONFIG_PACKET=y
CONFIG_UNIX=y
CONFIG_INET=y
CONFIG_IP_PNP=y
CONFIG_IP_PNP_DHCP=y
# CONFIG_IPV6 is not set
# CONFIG_STANDALONE is not set
# CONFIG_PREVENT_FIRMWARE_BUILD is not set
# CONFIG_FIRMWARE_IN_KERNEL is not set
CONFIG_DEBUG_DEVRES=y
CONFIG_MTD=y
CONFIG_MTD_STM_SPI_FSM=y
# CONFIG_BLK_DEV is not set
CONFIG_SCSI=y
# CONFIG_SCSI_PROC_FS is not set
CONFIG_BLK_DEV_SD=y
# CONFIG_SCSI_LOWLEVEL is not set
CONFIG_NETDEVICES=y
CONFIG_NWHW_CONFIG=y
# CONFIG_NET_VENDOR_BROADCOM is not set
# CONFIG_NET_VENDOR_CHELSIO is not set
# CONFIG_NET_VENDOR_CIRRUS is not set
# CONFIG_NET_VENDOR_FARADAY is not set
# CONFIG_NET_VENDOR_INTEL is not set
# CONFIG_NET_VENDOR_MARVELL is not set
# CONFIG_NET_VENDOR_MICREL is not set
# CONFIG_NET_VENDOR_NATSEMI is not set
# CONFIG_NET_VENDOR_SEEQ is not set
# CONFIG_NET_VENDOR_SMSC is not set
CONFIG_STMMAC_ETH=y
CONFIG_STM_ISVE=y
CONFIG_USB_USBNET=y
# CONFIG_USB_NET_CDCETHER is not set
# CONFIG_USB_NET_CDC_NCM is not set
# CONFIG_USB_NET_NET1080 is not set
# CONFIG_USB_NET_CDC_SUBSET is not set
# CONFIG_USB_NET_ZAURUS is not set
# CONFIG_WLAN is not set
# CONFIG_INPUT_MOUSEDEV is not set
# CONFIG_INPUT_KEYBOARD is not set
# CONFIG_INPUT_MOUSE is not set
# CONFIG_SERIO is not set
CONFIG_VT_HW_CONSOLE_BINDING=y
# CONFIG_LEGACY_PTYS is not set
# CONFIG_DEVKMEM is not set
CONFIG_HW_RANDOM=y
CONFIG_HW_RANDOM_STM=y
CONFIG_I2C=y
CONFIG_I2C_STM=y
CONFIG_GPIO_SYSFS=y
CONFIG_SENSORS_STM_PWM=y
CONFIG_SENSORS_STM_TEMP=y
CONFIG_SSB=m
CONFIG_MFD_SM501=m
CONFIG_MFD_SM501_GPIO=y
CONFIG_USB=y
CONFIG_USB_EHCI_HCD=y
CONFIG_USB_OHCI_HCD=y
CONFIG_USB_STORAGE=y
CONFIG_NEW_LEDS=y
CONFIG_LEDS_CLASS=y
CONFIG_LEDS_GPIO=y
CONFIG_LEDS_TRIGGERS=y
CONFIG_LEDS_TRIGGER_HEARTBEAT=y
CONFIG_LEDS_TRIGGER_DEFAULT_ON=y
CONFIG_DMADEVICES=y
CONFIG_STM_FDMA=y
# CONFIG_STM_FDMA_AUDIO is not set
# CONFIG_STM_FDMA_MCHI is not set
# CONFIG_STM_FDMA_TELSS is not set
# CONFIG_IOMMU_SUPPORT is not set
CONFIG_STM_PCIE=y
# CONFIG_STM_RNG is not set
CONFIG_EXT2_FS=y
CONFIG_EXT3_FS=y
# CONFIG_EXT3_DEFAULTS_TO_ORDERED is not set
# CONFIG_DNOTIFY is not set
CONFIG_TMPFS=y
CONFIG_TMPFS_POSIX_ACL=y
# CONFIG_MISC_FILESYSTEMS is not set
CONFIG_NFS_FS=y
CONFIG_NFS_V3=y
CONFIG_NFS_V4=y
CONFIG_ROOT_NFS=y
CONFIG_PRINTK_TIME=y
CONFIG_FRAME_WARN=2048
CONFIG_MAGIC_SYSRQ=y
CONFIG_UNUSED_SYMBOLS=y
# CONFIG_SCHED_DEBUG is not set
# CONFIG_DEBUG_PREEMPT is not set
CONFIG_DEBUG_INFO=y
# CONFIG_FTRACE is not set
CONFIG_CRYPTO_ANSI_CPRNG=y
```

## arch/arm/configs/fli76xxhdk01_defconfig
```kconfig
CONFIG_EXPERIMENTAL=y
CONFIG_LOCALVERSION="-fli76xxhdk01"
# CONFIG_LOCALVERSION_AUTO is not set
CONFIG_SYSVIPC=y
CONFIG_POSIX_MQUEUE=y
CONFIG_BSD_PROCESS_ACCT=y
CONFIG_TASKSTATS=y
CONFIG_TASK_DELAY_ACCT=y
CONFIG_TASK_XACCT=y
CONFIG_TASK_IO_ACCOUNTING=y
CONFIG_AUDIT=y
CONFIG_IKCONFIG=y
CONFIG_IKCONFIG_PROC=y
CONFIG_CGROUPS=y
CONFIG_CGROUP_FREEZER=y
CONFIG_CGROUP_DEVICE=y
CONFIG_CPUSETS=y
CONFIG_CGROUP_CPUACCT=y
CONFIG_RESOURCE_COUNTERS=y
CONFIG_CGROUP_MEM_RES_CTLR=y
CONFIG_CGROUP_MEM_RES_CTLR_SWAP=y
CONFIG_NAMESPACES=y
CONFIG_RELAY=y
CONFIG_CC_OPTIMIZE_FOR_SIZE=y
CONFIG_SYSCTL_SYSCALL=y
CONFIG_KALLSYMS_ALL=y
CONFIG_EMBEDDED=y
# CONFIG_COMPAT_BRK is not set
CONFIG_KPROBES=y
CONFIG_MODULES=y
CONFIG_MODULE_UNLOAD=y
CONFIG_MODULE_SRCVERSION_ALL=y
CONFIG_BLK_DEV_INTEGRITY=y
CONFIG_ARCH_STM=y
CONFIG_MACH_STM_FLI7610=y
CONFIG_MACH_STM_FLI76XXHDK01=y
# CONFIG_SWP_EMULATE is not set
CONFIG_ARM_ERRATA_743622=y
CONFIG_ARM_ERRATA_751472=y
CONFIG_PL310_ERRATA_753970=y
CONFIG_ARM_ERRATA_754322=y
CONFIG_ARM_ERRATA_775420=y
CONFIG_ARM_ERRATA_764369=y
CONFIG_PL310_ERRATA_769419=y
CONFIG_PCI=y
CONFIG_PCI_MSI=y
CONFIG_SMP=y
CONFIG_VMSPLIT_2G=y
CONFIG_NR_CPUS=2
CONFIG_PREEMPT=y
CONFIG_AEABI=y
# CONFIG_OABI_COMPAT is not set
CONFIG_KSM=y
CONFIG_CPU_FREQ=y
CONFIG_VFP=y
CONFIG_NEON=y
# CONFIG_SUSPEND is not set
# CONFIG_CORE_DUMP_DEFAULT_ELF_HEADERS is not set
# CONFIG_HIBERNATION_ON_MEMORY is not set
# CONFIG_PM_RUNTIME is not set
CONFIG_NET=y
CONFIG_PACKET=y
CONFIG_UNIX=y
CONFIG_INET=y
CONFIG_IP_PNP=y
CONFIG_IP_PNP_DHCP=y
CONFIG_IPV6=y
CONFIG_INET6_XFRM_MODE_TRANSPORT=m
CONFIG_INET6_XFRM_MODE_TUNNEL=m
CONFIG_INET6_XFRM_MODE_BEET=m
CONFIG_IPV6_SIT=m
CONFIG_NETFILTER=y
# CONFIG_STANDALONE is not set
# CONFIG_PREVENT_FIRMWARE_BUILD is not set
# CONFIG_FIRMWARE_IN_KERNEL is not set
CONFIG_DEBUG_DEVRES=y
CONFIG_CONNECTOR=y
CONFIG_MTD=y
CONFIG_MTD_CMDLINE_PARTS=y
CONFIG_MTD_CFI=y
CONFIG_MTD_M25P80=y
CONFIG_MTD_NAND=y
CONFIG_MTD_NAND_STM_BCH=y
CONFIG_MTD_NAND_STM_FLEX=y
CONFIG_MTD_NAND_STM_AFM=y
CONFIG_MTD_UBI=y
CONFIG_BLK_DEV_LOOP=y
CONFIG_BLK_DEV_RAM=y
CONFIG_BLK_DEV_RAM_SIZE=16384
# CONFIG_SCSI_PROC_FS is not set
CONFIG_BLK_DEV_SD=y
# CONFIG_SCSI_LOWLEVEL is not set
CONFIG_ATA=y
CONFIG_SATA_SIL24=y
CONFIG_SATA_STM=y
CONFIG_NETDEVICES=y
CONFIG_NWHW_CONFIG=y
CONFIG_STMMAC_ETH=y
CONFIG_VIA_RHINE=m
CONFIG_VIA_RHINE_MMIO=y
CONFIG_VIA_VELOCITY=y
CONFIG_ICPLUS_PHY=y
CONFIG_MDIO_BITBANG=y
CONFIG_MDIO_GPIO=y
CONFIG_USB_PEGASUS=y
CONFIG_USB_RTL8150=y
CONFIG_USB_USBNET=y
# CONFIG_USB_NET_NET1080 is not set
# CONFIG_USB_NET_CDC_SUBSET is not set
# CONFIG_USB_NET_ZAURUS is not set
# CONFIG_INPUT_MOUSEDEV is not set
# CONFIG_INPUT_KEYBOARD is not set
# CONFIG_INPUT_MOUSE is not set
# CONFIG_SERIO is not set
CONFIG_VT_HW_CONSOLE_BINDING=y
# CONFIG_LEGACY_PTYS is not set
# CONFIG_DEVKMEM is not set
CONFIG_HW_RANDOM=y
CONFIG_I2C=y
CONFIG_I2C_CHARDEV=y
CONFIG_I2C_STM=y
CONFIG_SPI=y
CONFIG_SPI_DEBUG=y
CONFIG_SPI_GPIO=y
CONFIG_SPI_STM=y
CONFIG_PPS=m
CONFIG_GPIO_SYSFS=y
CONFIG_SENSORS_STM_PWM=y
CONFIG_SENSORS_STM_TEMP=y
CONFIG_SSB=m
CONFIG_MFD_SM501=m
CONFIG_MFD_SM501_GPIO=y
CONFIG_MEDIA_SUPPORT=y
CONFIG_VIDEO_DEV=y
CONFIG_DVB_CORE=y
# CONFIG_MEDIA_TUNER_CUSTOMISE is not set
# CONFIG_USB_GSPCA is not set
# CONFIG_V4L_PCI_DRIVERS is not set
CONFIG_V4L_MEM2MEM_DRIVERS=y
# CONFIG_RADIO_ADAPTERS is not set
# CONFIG_DVB_FE_CUSTOMISE is not set
# CONFIG_VGA_ARB is not set
CONFIG_FB=y
CONFIG_FB_SOFTWARE_DRAWING_HELPERS=y
CONFIG_FRAMEBUFFER_CONSOLE=y
CONFIG_SOUND=y
CONFIG_SND=y
CONFIG_SND_SEQUENCER=y
CONFIG_SND_MIXER_OSS=y
CONFIG_SND_PCM_OSS=y
CONFIG_SND_STM=y
CONFIG_SND_STM_FLI7610=y
# CONFIG_SND_STM_STIH415 is not set
CONFIG_USB=y
CONFIG_USB_ANNOUNCE_NEW_DEVICES=y
CONFIG_USB_EHCI_HCD=y
CONFIG_USB_OHCI_HCD=y
CONFIG_USB_STORAGE=y
CONFIG_MMC=y
CONFIG_MMC_SDHCI=y
CONFIG_MMC_SDHCI_PLTFM=y
CONFIG_MMC_SDHCI_STM=y
CONFIG_NEW_LEDS=y
CONFIG_LEDS_CLASS=y
CONFIG_LEDS_GPIO=y
CONFIG_LEDS_TRIGGERS=y
CONFIG_LEDS_TRIGGER_HEARTBEAT=y
CONFIG_STM_PCIE=y
CONFIG_STM_COPROCESSOR_CLASS=y
CONFIG_STM_COPROCESSOR_ST40=y
CONFIG_STM_COPROCESSOR_ST200=y
# CONFIG_STM_RNG is not set
CONFIG_STM_MALI=y
CONFIG_EXT2_FS=y
CONFIG_EXT3_FS=y
# CONFIG_EXT3_DEFAULTS_TO_ORDERED is not set
CONFIG_XFS_FS=y
# CONFIG_DNOTIFY is not set
CONFIG_TMPFS=y
CONFIG_TMPFS_POSIX_ACL=y
CONFIG_NFS_FS=y
CONFIG_NFS_V3=y
CONFIG_ROOT_NFS=y
CONFIG_PRINTK_TIME=y
CONFIG_FRAME_WARN=2048
CONFIG_MAGIC_SYSRQ=y
CONFIG_UNUSED_SYMBOLS=y
CONFIG_DEBUG_FS=y
# CONFIG_SCHED_DEBUG is not set
# CONFIG_DEBUG_PREEMPT is not set
CONFIG_DEBUG_INFO=y
# CONFIG_RCU_CPU_STALL_VERBOSE is not set
# CONFIG_FTRACE is not set
CONFIG_SECURITYFS=y
CONFIG_CRYPTO_MANAGER=y
CONFIG_CRYPTO_SEQIV=y
CONFIG_CRYPTO_CRC32C=y
# CONFIG_CRYPTO_ANSI_CPRNG is not set
# CONFIG_CRYPTO_HW is not set
```
