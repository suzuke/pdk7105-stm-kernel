## arch/arm/mach-stm/Kconfig
```kconfig
menu "STMicroelectronics Consumer Electronics platform type"
	depends on ARCH_STM

# CPU_SUBTYPE_xxx style names for code shared with SH4

config CPU_SUBTYPE_FLI7610
       def_bool n

config CPU_SUBTYPE_STIH415
       def_bool n

config CPU_SUBTYPE_STIH416
       def_bool n

config CPU_SUBTYPE_STIG125
       def_bool n

config MACH_STM_FLI7610
	def_bool n
	select CPU_SUBTYPE_FLI7610
	select STM_HAS_MALI
	help
	  Include support for a generic FLI7610 (Newman) platform.

config MACH_STM_STIG125
	def_bool n
	select STM_IRQ_MUX
	select CPU_SUBTYPE_STIG125
	help
	  Include support for a generic STiG125 (Barcelona) platform.

config MACH_STM_STID127
	def_bool n
	select STM_IRQ_MUX
	help
	  Include support for a generic STiD127 (Alicante) platform.

config MACH_STM_STIG125_BOARD
	bool "Generic board support for StiG125 based boards via Device trees"
	depends on OF
	select MACH_STM_STIG125
	help
	Include support for a Generic Board based on device trees for
	StiG125

config MACH_STM_STIH415
	def_bool n
	select CPU_SUBTYPE_STIH415
	select ARCH_HAS_CPUFREQ
	select STM_HAS_MALI
	help
	  Include support for a generic STiH415 (Orly) platform.

config MACH_STM_STIH415_BOARD
	bool "Generic board support for STiH415 based boards via Device trees"
	depends on OF
	select MACH_STM_STIH415
	help
	Include support for a Generic Board based on device trees for
	StiH415 (Orly-1)

config MACH_STM_STIH416
	def_bool n
	select ARCH_HAS_CPUFREQ
	select CPU_SUBTYPE_STIH416
	select STM_HAS_MALI
	help
	 Include support for a generic STiH416 (Orly-2) platform.

config MACH_STM_STIH416_BOARD
	bool "Generic board support for STiH416 based boards via Device trees"
	depends on OF
	select MACH_STM_STIH416
	help
	Include support for a Generic Board based on device trees for
	StiH416 (Orly-2)

config MACH_STM_B2000
	bool "Support B2000 - STiH415/STiH416 (Orly/Orly-2) MBoard"
	help
	  Include support for a B2000 - STiH415/STiH416 (Orly/Orly-2) MBoard.

# b2000 specific configuration
source "arch/arm/mach-stm/Kconfig.b2000"

config MACH_STM_B2020
	bool "Support B2020 - STiH415/STiH416 (Orly-1/Orly-2) ADI Board"
	help
	  Include support for a B2020 - STiH415/STiH416 (Orly-1/Orly-2) ADI Board.

# b2020 specific configuration
source "arch/arm/mach-stm/Kconfig.b2020"


config MACH_STM_B2044
	bool "Support B2044 - STiG125 (Barcelona) Evaluation Board"
	select MACH_STM_STIG125
	help
	  Include support for a B2044 - STiG125 (Barcelona) Evaluation Board.

# b2044 specific configuration
source "arch/arm/mach-stm/Kconfig.b2044"

config MACH_STM_B2078
	bool "Support B2078 - STiG125 (Docsis3) Reference Board"
	select MACH_STM_STIG125
	help
	  Include support for a B2078 - STiG125 (Docsis3) Reference Board.

config MACH_STM_B2092
	bool "Support B2092 - STiH416 (Orly-2) MBoard"
	select MACH_STM_STIH416
	help
	  Include support for a B2092 - STiH416 (Orly-2) MBoard.

# b2092 specific configuration
source "arch/arm/mach-stm/Kconfig.b2092"

config MACH_STM_B2105
	bool "Support B2105 - STiH416 (Orly-2) Zaragoza Premium board"
	select MACH_STM_STIH416
	select FIXED_PHY
	help
	  Include support for a B2105 - STiH416 (Orly-2) Zaragoza Premium board.

config MACH_STM_FLI76XXHDK01
	bool "Support FLI76XX HDK01 - FLI7610 (Newman) Board"
	select MACH_STM_FLI7610
	help
	  Include support for a FLI76XX HDK01 (Newman) Board.

config MACH_STM_B2112
	bool "Support B2112 STiG125/STiD127 (Alicante Cut0/1) Module for Zaragoza"
	help
	  Include support for a B2112 - (Alicante) Module for
	  Zaragoza Premium.

if MACH_STM_B2112

choice
	prompt "B2112: System-On-Chip selection"
	default MACH_STM_STIG125
	help
	  Select the appropriate SoC on-board.

config MACH_STM_B2112_STIG125
	bool "B2112 with STiG125 (Alicante Cut 0) SoC"
	select MACH_STM_STIG125
	help
	  This is to select a B2112 board developed to support the
	  Alicante cut0 SoC based on STIG125 SASC1.

config MACH_STM_B2112_STID127
	bool "B2112 with STiD127 (Alicante Cut 1) SoC"
	select MACH_STM_STID127
	help
	  This is to select a B2112 board developed to support the
	  Alicante cut1 SoC based on STID127.

endchoice

endif

config MACH_STM_B2110
	bool "Support B2110 STiD127 (Alicante Cut1)"
	select MACH_STM_STID127
	help
	  Include support for a B2110 - (Alicante cut 1) Module for
	  Zaragoza Premium.

if MACH_STM_STIG125

config	STM_ISVE_EROUTER
	bool "Manage the eRouter interfarce through ISVE"
	depends on STM_ISVE
	help
	  Select this option if the eRouter interface (if1)
	  has to be managed by using the ISVE Virtual driver
	  instead of the FastPath.

endif

config STM_CPU_FREQ
	def_bool CPU_FREQ
	select CPU_FREQ_TABLE

endmenu
```

## arch/arm/mach-stm/Kconfig.b2020
```kconfig
if MACH_STM_B2020

choice
	prompt "B2020: System-On-Chip selection"
	default MACH_STM_B2020_STIH415
	help
	  Select the appropriate SoC on-board.

config MACH_STM_B2020_STIH415
	bool "B2020 with STiH415 (Orly-1) SoC"
	select MACH_STM_STIH415
	help
	  Select the appropriate SoC which the board is socketed with

config MACH_STM_B2020_STIH416
	bool "B2020 with STiH416 (Orly-2) SoC"
	select MACH_STM_STIH416
	help
	  Select the appropriate SoC which the board is socketed with

endchoice

endif
```

## arch/arm/mach-stm/Kconfig.b2044
```kconfig
if MACH_STM_B2044

choice
	prompt "B2044: card selection on CN55 connector"
	default MACH_STM_B2044_CN55_NONE
	help
	  Select the appropriate version of the MMC card.

config MACH_STM_B2044_CN55_NONE
	bool "None"
	help
	  No card is plugged into CN55 of the B2044.

config MACH_STM_B2044_CN55_B2048
	bool "B2048A - eMMC/MMC Module"
	help
	  B2048A connected to CN55 of B2044
	  There are two versions of this modules:
	  a card with an embedded MMC device and another one
	  with an MMC/SD slot.
endchoice

choice
	prompt  "B2048A slot/eMMC selection"
	depends on MACH_STM_B2044_CN55_B2048
	default MACH_STM_B2044_B2048_EMMC
	help
	  Select if the board has the eMMC or the MMC/SD slot.

config	MACH_STM_B2044_B2048_SLOT
	bool "Multi Media Card slot on daughter board"
	help
	  Select this option if the board has an MMC card slot.

config	MACH_STM_B2044_B2048_EMMC
	bool "Embedded Multi Media Card (eMMC) on daughter board"
	help
	  Select this option if the board has an eMMC device.

endchoice

endif
```

## arch/arm/mach-stm/Kconfig.b2092
```kconfig
if MACH_STM_B2092

choice
	prompt "B2092: card selection on CN22 connector"
	default MACH_STM_B2092_CN22_NONE
	help
	  Select the appropriate version of the GMAC0 Ethernet card.
	  This controls the way Ethernet connection mode with PHY.

config MACH_STM_B2092_CN22_NONE
	bool "None"
	help
	  No Ethernet card is plugged into CN22 of the B2092.

config MACH_STM_B2092_CN22_B2032
	bool "B2032A Card on GMAC0"
	help
	  B2032A Ethernet card on CN22 of B2092.

config MACH_STM_B2092_CN22_B2035
	bool "B2035 for GMAC0 and MMC/SD external slot"
	help
	  B2035 connected to CN22 of B2092

config MACH_STM_B2092_CN22_B2048
	bool "B2048A - eMMC/MMC Module"
	help
	  B2048A connected to CN22 of B2092.
	  There are two versions of this modules:
	  a card with the embedded MMC and onther one
	  with the MMC/SD slot.

config MACH_STM_B2092_CN22_B2107
	bool "B2107A - Dual eMMC/MMC Module"
	help
	  B2107A connected to CN22 of B2092.
	  There are two versions of this modules:
	  a card with the Dual embedded MMC and onther one
	  with embedded MMC and MMC/SD slot.

endchoice

choice
	prompt  "B2048A slot/eMMC selection"
	depends on MACH_STM_B2044_CN55_B2048 || MACH_STM_B2092_CN22_B2048
	default MACH_STM_B2092_B2048_EMMC
	help
	  Select if the board has the eMMC or the MMC/SD slot.

config	MACH_STM_B2092_B2048_SLOT
	bool "Multi Media Card slot on daughter board"
	help
	  Select this option if the board has an MMC card slot.

config	MACH_STM_B2092_B2048_EMMC
	bool "Embedded Multi Media Card (eMMC) on daughter board"
	help
	  Select this option if the board has an eMMC device.
endchoice

choice
	prompt  "B2107A slot/eMMC selection"
	depends on MACH_STM_B2092_CN22_B2107
	default MACH_STM_B2092_B2107_DUAL_EMMC
	help
	  Select if the board has the dual eMMC or mixed option MMC and eMMC.

config	MACH_STM_B2092_B2107_MMC_EMMC
	bool "Embedded Multi Media Card and slot on daughter board"
	help
	  Select this option if the board has an MMC card slot and an eMMC.

config	MACH_STM_B2092_B2107_DUAL_EMMC
	bool "Dual Embedded Multi Media Card (eMMC) on daughter board"
	help
	  Select this option if the board has adual  eMMC device.

endchoice

config MACH_STM_B2092_CN22_B2032_GIGA_MODE
	bool "B2032A: enable GMAC0 in GMII/RMII mode"
	depends on MACH_STM_B2092_CN22_B2032
	help
	  Select this options to support the GMII/RGMII
	  on GMAC0. The B2032A moudule has to be modified
	  to support this modes.
	  By default the GMAC0 works in MII mode.
	  Do not select it if you want the GMAC in MII mode.

choice
	prompt  "Select GiGa mode"
	default MACH_STM_B2092_CN22_B2032_GMII_MODE
	depends on MACH_STM_B2092_CN22_B2032_GIGA_MODE
	help
	  Select this options to support the GMII/RGMII
	  on GMAC1. The B2032A moudule has to be modified
	  to support this modes.
	  By default the GMAC1 works in MII mode.
	  Do not select it if you want the GMAC in MII mode.

config MACH_STM_B2092_CN22_B2032_GMII_MODE
	bool "B2032A module modified for GMII mode"
	depends on MACH_STM_B2092_CN22_B2032_GIGA_MODE
	help
	  B2032A Ethernet card on CN22 of B2092.

config MACH_STM_B2092_CN22_B2032_RGMII_MODE
	bool "B2032A module modified for RGMII mode"
	depends on MACH_STM_B2092_CN22_B2032_GIGA_MODE
	help
	  B2032A Ethernet card on CN22 of B2092.

endchoice


choice
	prompt "B2092: card selection on CN23 connector"
	default	MACH_STM_B2092_CN23_NONE
	help
	  Select the appropriate version of the GMAC1 Ethernet card.
	  This controls the way Ethernet connection mode with PHY.

config	MACH_STM_B2092_CN23_NONE
	bool "None"
	help
	  No Ethernet card is plugged into CN23 of the B2092.

config	MACH_STM_B2092_CN23_B2032
	bool "B2032A Card on GMAC1"
	help
	  B2032A Ethernet card on CN23 of B2092.

config	MACH_STM_B2092_CN23_B2035
	bool "B2035A Card on GMAC1"
	help
	  B2035A Ethernet card on CN23 of B2092.

endchoice


config MACH_STM_B2092_CN23_B2032_GIGA_MODE
	bool "B2032A: enable GMAC0 in GMII/RMII mode"
	depends on MACH_STM_B2092_CN23_B2032
	help
	  Select this options to support the GMII/RGMII
	  on GMAC1. The B2032A moudule has to be modified
	  to support this modes.
	  By default the GMAC1 works in MII mode.
	  Do not select it if you want the GMAC in MII mode.

choice
	prompt  "Select GiGa mode"
	default MACH_STM_B2092_CN23_B2032_GMII_MODE
	depends on MACH_STM_B2092_CN23_B2032_GIGA_MODE

config MACH_STM_B2092_CN23_B2032_GMII_MODE
	bool "B2032A module modified for GMII mode"
	depends on MACH_STM_B2092_CN23_B2032_GIGA_MODE
	help
	  B2032A Ethernet card on CN23 of B2092.

config MACH_STM_B2092_CN23_B2032_RGMII_MODE
	bool "B2032A module modified for RGMII mode"
	depends on MACH_STM_B2092_CN23_B2032_GIGA_MODE
	help
	  B2032A Ethernet card on CN23 of B2092.

endchoice



endif
```
