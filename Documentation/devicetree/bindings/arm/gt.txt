## Documentation/devicetree/bindings/arm/gt.txt
```
* ARM Global Timer
	Cortex-A9 are often associated with a per-core Global timer.

** Timer node required properties:

- compatible : Should be one of:
	"arm,cortex-a9-global-timer"

- interrupts : One interrupt to each core

- reg : Specify the base address and the size of the GT timer
	register window.

Example:

	gt-timer@2c000600 {
		compatible = "arm,cortex-a9-global-timer";
		reg = <0x2c000600 0x20>;
		interrupts = <1 13 0xf01>;
	};
```

## Documentation/devicetree/bindings/ata/ahci-stm.txt
```
* AHCI SATA Controller on STM SOC's

Required properties:
- compatible        : should be "st,ahci"
- interrupts        : <interrupt mapping for SATA IRQ>
- reg               : <registers mapping>
- miphy-num	: MiPHY number to use.
- device-config : phandle to device config.

Example:

	sata0: ahci@fefb0000 {
                #address-cells = <1>;
                #size-cells = <1>;
		compatible	= "st,ahci", "simple-bus";
		reg		= <0xfefb0000 0x1000>;
		interrupts	=  <0 84 0>;
		interrupt-names = "ahci";
		status		= "disabled";
		miphy_num	= <0>;
		device-config = <&sata0_dev_config>;
		sata0_dev_config: sata_dev_config-0 {
			#stm-sysconf-cells = <4>;
			device-seqs = <&sata0_dev_seqs>;
			sysconfs{
				AHCI_HOST_PWR =	<&sysconf 266 0 0>;
				AHCI_HOST_PWR_ACK = <&sysconf 281 0 0>;
			};
		};
	};
```

## Documentation/devicetree/bindings/ata/stm-sata.txt
```
===============================================================================
				st,sata
===============================================================================

Required properties:
- compatible : "st,sata".
- reg, reg-names, interrupts, interrupt-names	: Standard way to define device
			resources with names. look in
			Documentation/devicetree/bindings/resource-names.txt

- st,port		interger defining the port number to associate with.
- st,phy-init		32 bit Initial value for PHYCR register.
- st,pc-glue		32 bit value of SATA PC_GLUE logic register.
- st,oob_wa		to enable/disable OOB workaround to pass OOB-06(a)
			certification.
- st,miphy-num		interger defining miphy lane to be associated with.
- st,dev-config	STM standard way to pass device resources.
			look in Documentation/devicetree/bindings/stm-dev-config.txt
			and
			Documentation/devicetree/bindings/stm-pad.txt

Example:
	sata0: sata@fe818000{
		#interrupt-cells = <3>;
                #address-cells = <1>;
                #size-cells = <1>;
		interrupt-parent = <&intc>;
		compatible	= "st,sata", "simple-bus";
		reg		= <0xfe818000 0x1000>;
		interrupts	=  <0 161 0>, <0 162 0>;
		interrupt-names = "hostc", "dmac";
		status		= "disabled";

		device-config = <&sata0_dev_config>;
		amba-config = <&sata_amba_config>;

		st,oob_wa;
		st,port = <0>;
		stm.miphy = <0>;

		sata0_dev_config: sata0-dev-config {
			#stm-sysconf-cells = <4>;
			device-seqs = <&sata_dev_seqs>;
			sysconfs {
				SATA_ACK =	<&stih415_sysconf 384 3 3>;
				SATA_HC_PWR =	<&stih415_sysconf 336 3 3>;
			};
		};
	};

	sata_dev_seqs: sata-dev-seqs{
		power-on-seq{
			step0 {
				SATA_HC_PWR = <0>;
				type = "sysconf";
			};
			step1{
				SATA_ACK = <0>;
				type = "sysconf-feedback";
			};
		};
		power-off-seq{
			step0 {
				SATA_HC_PWR = <1>;
				type = "sysconf";
			};
			step1{
				SATA_ACK = <1>;
				type = "sysconf-feedback";
			};
		};
	};
```

## Documentation/devicetree/bindings/dma/stm-fdma-xbar.txt
```
===============================================================================
			stm fdma-xbar
===============================================================================

Required properties:
- compatible : Should be "st,fdma-xbar".
- reg, reg-names, interrupts, interrupt-names	: Standard way to define device
			resources with names. look in
			Documentation/devicetree/bindings/resource-names.txt
- first-fdma	First fdma id.
- last-fdma	Last fdma id.

Example:

	fdma_xbar_sas: fdma-xbar-sas {
		compatible	= "st,fdma-xbar", "simple-bus";
		reg		= <0xfee61000 0x1000>;
		first-fdma	= <3>;
		last-fdma	= <4>;
	};
```

## Documentation/devicetree/bindings/dma/stm-fdma.txt
```
===============================================================================
			stm fdma
===============================================================================

Required properties:
- compatible : Should be "st,fdma".
- reg, reg-names, interrupts, interrupt-names	: Standard way to define device
			resources with names. look in
			Documentation/devicetree/bindings/resource-names.txt

- fw-regs	phandle to firmware register offsets.
		Below are the possible offsets descriptions of fw registers.
	- fw-rev-id    : Should be firmware revision id register offset.
	- fw-cmd-statn : is offset to cmd statn register.
	- fw-req-ctln  : is offset to request contrl register.
	- fw-ptrn      : is offset to ptrn register
	- fw-cntn      : is offset to cntn register.
	- fw-saddrn    : is offset to saddr register.
	- fw-daddrn    : is offset to daddr register.
	- fw-node-size : is offset to node-size register.

- hw-conf	phandle to hw register offsets.
		Below are the possible offsets descriptions of hw registers.
	- slim-reg-id		: offset of id slim core register.
	- slim-reg-ver		: offset of ver slim core register.
	- slim-reg-en		: offset of enable slim core register.
	- slim-reg-clk-gate	: offset of clk gate slim core register

	- dmem-offset		: dmem offset
	- dmem-size		: dmem size

	- periph-reg-sync-reg : offset of periph sync register.
	- periph-reg-cmd-sta  : offset of periph cmd register.
	- periph-reg-cmd-set  : offset of periph cmd set register.
	- periph-reg-cmd-clr  : offset of periph cmd clr register.
	- periph-reg-cmd-mask : offset of periph cmd mask register.
	- periph-reg-int-sta  : offset of periph int stat register.
	- periph-reg-int-set  : offset of periph int set register.
	- periph-reg-int-clr  : offset of periph int clr register.
	- periph-reg-int-mask : offset of periph int mask register.

	- imem-offset		: offset of imem
	- imem-size		: size of imem.
- xbar		Xbar number to use.

Example:
fdma0_mpe:fdma-mpe@0{
	compatible	= "st,fdma", "simple-bus";
	reg		= <0xfd600000 0x20000>;
	interrupts	=  <0 10 0>;
	hw-conf = <&fdma_hw_config>;
	fw-regs = <&fdma_fw_regs>;
	x-bar	= <0>;

};
fdma_xbar_mpe: fdma-xbar-mpe {
	compatible	= "st,fdma-xbar", "simple-bus";
	reg		= <0xfd6df000 0x1000>;
	st,first_fdma	= <0>;
	st,last_fdma	= <2>;
};

fdma_fw_regs: fdma-fw-regs{
	fw-rev-id    = <0x10000>;
	fw-cmd-statn = <0x10200>;
	fw-req-ctln  = <0x10240>;
	fw-ptrn      = <0x10800>;
	fw-cntn      = <0x10808>;
	fw-saddrn    = <0x1080c>;
	fw-daddrn    = <0x10810>;
	fw-node-size = <128>;
};

fdma_hw_config: fdma-hw-config {
	slim-reg-id       = <0x0>;
	slim-reg-ver      = <0x4>;
	slim-reg-en       = <0x8>;
	slim-reg-clk-gate = <0xc>;

	dmem-offset = <0x10000>;
	dmem-size   = <0x3000>;

	periph-reg-sync-reg = <0x17f88>;
	periph-reg-cmd-sta  = <0x17fc0>;
	periph-reg-cmd-set  = <0x17fc4>;
	periph-reg-cmd-clr  = <0x17fc8>;
	periph-reg-cmd-mask = <0x17fcc>;
	periph-reg-int-sta  = <0x17fd0>;
	periph-reg-int-set  = <0x17fd4>;
	periph-reg-int-clr  = <0x17fd8>;
	periph-reg-int-mask = <0x17fdc>;

	imem-offset = <0x18000>;
	imem-size   = <0x6000>;
};
```

## Documentation/devicetree/bindings/gpio/gpio-stm-irqmux.txt
```
===============================================================================
STM GPIO irqmux bindings
===============================================================================

Required properties:
- compatible:
  - "st,gpio-irqmux" for all STMicroelectronics gpio irqmux
- reg, reg-names, interrupts, interrupt-names	: Standard way to define device
			resources with names. look in
			Documentation/devicetree/bindings/resource-names.txt
- first-port 	First GPIO bank where this interrupt belongs to.
- ports		Number of GPIOS banks to with this interrupt belongs to.

Example:

gpio-irqmux@fe61f080{
	compatible	= "st,gpio-irqmux", "simple-bus";
	reg =	<0xfe61f080 0x4>;
	interrupts = <0 180 0x0>;
	first-port = <0>;
	ports = <5>;
};
```

## Documentation/devicetree/bindings/gpio/gpio-stm.txt
```
===============================================================================
STM GPIO controller bindings
===============================================================================

Required properties:
- compatible:
  - "st,gpio" for all STMicroelectronics gpio controllers
- reg, reg-names, interrupts, interrupt-names	: Standard way to define device
			resources with names. look in
			Documentation/devicetree/bindings/resource-names.txt
- #gpio-cells : Should be one.
  - first cell is the pin number
- gpio-controller : Marks the device node as a GPIO controller.

ST specific properties:
- bank-names: Userfriendly name to show up in debugfs.


Example:

PIO1: PIO@fe611000 {
	#gpio-cells = <1>;
        compatible = "st,gpio";
	reg = <0xfe611000 0x100>;
	bank-name  = "PIO1";
};
```

## Documentation/devicetree/bindings/hwmon/stm-pwm.txt
```
===============================================================================
			stm pwm
===============================================================================

Required properties:
- compatible : "st,pwm".
- reg, reg-names, interrupts, interrupt-names	: Standard way to define device
			resources with names. look in
			Documentation/devicetree/bindings/resource-names.txt

Required properties(Per Channel):
- padcfg	Standard way to pass pad config to the drivers.
- #address-cells: fixed to 1
- #size-cells: fixed to 0
- child nodes for each pwm channel, which may contain following properties
    - reg: defines the channel number
    - st,initial-value: initial channel config required to be done during probe
    - st,retain-hw-value: channel config programmed by bootloader to be retained
    - st,locked: the channel is readonly for user

Example:
	pwm {
		compatible	= "st,pwm", "simple-bus";
		reg		= <0xfed10000 0x68>;
		interrupts	=  <0 200 0>;
		status = "disabled";
		padcfg-names = "chan0", "chan1";
		padcfg-0 = <&padcfg_pwm0_chan0>;
		padcfg-1 = <&padcfg_pwm0_chan1>;
        #address-cells = <1>;
        #size-cells = <0>;
        pwm-channel@0 {
                reg = <0>;
                st,retain-hw-value;
                status = "disabled";
        };
	}
```

## Documentation/devicetree/bindings/hwmon/stm-temp.txt
```
===============================================================================
				stm temp
===============================================================================

Required properties:
- compatible : "st,pwm".
- reg, reg-names, interrupts, interrupt-names	: Standard way to define device
			resources with names. look in
			Documentation/devicetree/bindings/resource-names.txt
- st,calibrated  bool flag to indicate if the sensor is already calibrated.
- st, calibration-value should be integer calibration value.
- device-config	Standard way to pass device config to the drivers.

Example:
temp0{
        compatible    = "st,temp", "simple-bus";
        status = "okay";
        device-config = <&temp_device_config>;
    };
```

## Documentation/devicetree/bindings/i2c/stm-i2c.txt
```
===============================================================================
				stm i2c
===============================================================================

Required properties:
- compatible : "st,i2c".
- reg, reg-names, interrupts, interrupt-names	: Standard way to define device
			resources with names. look in
			Documentation/devicetree/bindings/resource-names.txt
- i2c-fastmode      takes value of 0 or 1 to disable or enable i2c fastmode
			respectively.
- padcfg-0	is the standard way to pass pad config to the drivers.

Optional properties:
- dev-clk		specify device clk or alias clk.

Example:

	i2c0: i2c-stm0{
		#interrupt-cells = <3>;
        #address-cells = <1>;
        #size-cells = <1>;
		interrupt-parent = <&intc>;
		compatible	= "st,i2c", "simple-bus";
		reg		= <0xfed40000 0x110>;
		interrupts	=  <0 187 0>;
		status = "disabled";
		st,i2c-fastmode;
		padcfg-0 = <&ssc0_pad_config>;
	};
```

## Documentation/devicetree/bindings/media/rc/stm-rc.txt
```
===============================================================================
				stm lirc
===============================================================================

Required properties:
- compatible : should be "st,lirc".
- reg, reg-names, interrupts, interrupt-names	: Standard way to define device
			resources with names. look in
			Documentation/devicetree/bindings/resource-names.txt
- irb-clock		IRB block clock (set to 0 for auto)
- irb-clkdiv        IRB block clock divison (set to 0 for auto)
- irb-period-mult   manual setting period multiplier
- irb-period-div    manual setting period divisor
- irb-ontime-mult   manual setting pulse period multiplier
- irb-ontime-div    manual setting pulse period divisor
- irb-rxmax-period  maximum rx period in uS
- irb-version       RB version type (1,2 or 3)
- sys-clkdiv        factor to divide system bus clock by
- rx-polarity       flag to set gpio rx polarity (usually set to 1)
- sub-carrwidth     Subcarrier width in percent - this is used to make the
			subcarrier waveform square after passing through the
			555-based threshold detector on ST boards.
- rx-uhfmode        RX UHF mode enabled
- rx-ir-mode	RX IR Mode Enabled.
- tx-od-enabled	If Open Drain enabled for TX.
- device-config	to pass pad config to the drivers.
- sys-clk	to specify device clk or alias clk.

Example:
lirc {
	compatible	= "st,lirc", "simple-bus";
	status = "disabled";
	reg		= <0xfe518000 0x234>;
	interrupts	=  <0 203 0>;
	sys-clk	= "sbc_comms_clk";
	irb-clock		= <0>;
	irb-clkdiv		= <0>;
	irb-period-mult	= <0>;
	irb-period-div	= <0>;
	irb-ontime-mult	= <0>;
	irb-ontime-div	= <0>;
	irb-rxmax-period	= <0x5000>;
	irb-version		= <0>;
	sys-clkdiv		= <1>;
	rx-polarity		= <1>;
	sub-carrwidth	= <0>;
	device-config = <&lirc_ir_device_config>;

	lirc_ir_device_config: lirc-ir-dev-config {
		padcfg-0	= <&padcfg_ir>;
		device-seqs = <&lirc_dev_seqs>;
		sysconfs{
			irb-enabled	= <&lpm_sysconf 1 6 6>;
			irb-normal-mode = <&lpm_sysconf 1 7 7>;
		};
	};

	lirc_uhf_device_config: lirc-uhf-dev-config {
		padcfg-0	= <&padcfg_ir &padcfg_uhf>;
		device-seqs = <&lirc_dev_seqs>;
		sysconfs{
			irb-enabled	= <&lpm_sysconf 1 6 6>;
			irb-normal-mode = <&lpm_sysconf 1 7 7>;
		};
	};

	lirc_tx_device_config: lirc-tx-dev-config {
		padcfg-0	= <&padcfg_ir &padcfg_tx>;
		device-seqs = <&lirc_dev_seqs>;
		sysconfs{
			irb-enabled	= <&lpm_sysconf 1 6 6>;
			irb-normal-mode = <&lpm_sysconf 1 7 7>;
		};
	};
	lirc_tx_od_device_config: lirc-tx-od-dev-config {
		padcfg-0	= <&padcfg_ir &padcfg_tx_od>;
		device-seqs = <&lirc_dev_seqs>;
		sysconfs{
			irb-enabled	= <&lpm_sysconf 1 6 6>;
			irb-normal-mode = <&lpm_sysconf 1 7 7>;
		};
	};
	lirc_dev_seqs: lirc-dev-seqs{
		init-seq{
			step0 {
				irb-enabled = <1>;
				type = "sysconf";
			};
			step1 {
				irb-normal-mode = <0>;
				type = "sysconf";
			};
		};
	};
};
```

## Documentation/devicetree/bindings/mmc/stm-sdhci.txt
```
* STMicroElectronics Secure Digital Host Controller


Required properties:
- compatible : Should be "st,sdhci"
- reg : Should contain SD/MMC registers location and length
- interrupts : Should contain SD/MMC interrupt

Example:

sdhci@c8000200 {
	compatible = "st,sdhci";
	reg = <0xc8000200 0x200>;
	interrupts = <47>;
};
```
