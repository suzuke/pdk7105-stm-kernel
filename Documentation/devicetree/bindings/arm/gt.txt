## Documentation/devicetree/bindings/mtd/stm-nand.txt
```
===============================================================================
                STM NAND Support: FLEX, AFM, and BCH Drivers
===============================================================================

Required properties:

  - compatible          : Select according to STM NAND driver: "st,nand-afm",
                          "st,nand-bch", "st,nand-flex".

  - reg,                : Standard register descriptions for named resources:
  - reg-names,          :   "nand_mem" : NAND Controller register map
                            "nand_dma" : ["st,nand-bch ONLY"] BCH Controller DMA
                                           configuration map

  - interrupts,         : Standard description for named IRQ:
  - interrupt-names	:   "nand_irq" : NAND Controller IRQ

  - st,nand-banks       : Subnode representing one or more "banks" of NAND
                          Flash, connected to an STM NAND Controller (see
                          descriptin below).  Note, "st,nand-bch" only supports
                          a single connected NAND bank.

  - st,bch-ecc-mode     : ["st,nand-bch" ONLY] BCH ECC configuration mode:
                            "auto"  : Use strongest ECC supported by device
                            "noecc" : No ECC
                            "18bit" : Use 18-bit/1024B ECC
                            "30bit" : Use 30-bit/1024B ECC

  - st,bch-bitflip-threshold
                        : ["st,nand-bch" ONLY] The threshold at which the
                          number of corrected bit-flips per sector is deemed to
                          have reached an excessive level (triggers '-EUCLEAN'
                          to be returned to the caller).  The value should be
                          in the range 1 to <ecc-strength> where <ecc-strength>
                          is 18 or 30, depending on the BCH ECC mode in
                          operation.  A value of 0, or if left unspecified, is
                          interpreted by the driver as <ecc-strength>.

  - st,nand-flashss	: use flashSS sub-system instead of emiss (the default).

Properties describing Bank of NAND Flash ("st,nand-banks"):
  - st,nand-csn         : Chip select associated with the Bank.

  - st,nand-timing-spec : [Optional] NAND Device Timing Data.  All times
                          expressed in ns, except where stated otherwise:

                            tR           : Max Page Read delay [us]
                            tCLS         : Min CLE setup time
                            tCS          : Min CE setup time
                            tALS         : Min ALE setup time
                            tDS          : Min Data setup time
                            tWP          : Min WE pulse width
                            tCLH         : Min CLE hold time
                            tCH          : Min CE hold time
                            tALH         : Min ALE hold time
                            tDH          : Min Data hold time
                            tWB          : Max WE high to busy
                            tWH          : Min WE hold time
                            tWC          : Min Write cycle time
                            tRP          : Min RE pulse width
                            tREH         : Min RE high hold time
                            tRC          : Min Read cycle time
                            tREA         : Max Read access time
                            tRHOH        : Min RE high to output hold
                            tCEA         : Max CE access time
                            tCOH         : Min CE high to output hold
                            tCHZ         : Max CE high to output high Z
                            tCSD         : Min CE high to ALE/CLE don't care

  - st,nand-timing-data : [Optional, DEPRECATED] Legacy NAND Device Timing Data.
                          All times expressed in ns, except where stated
                          otherwise

                            sig-setup    : CL/AL setup time
                            sig-hold     : CL/AL hold time
                            CE-deassert  : Min CE deassert time
                            WE-to-RBn    : Min WE to RBn time
                            wr-on        : Write pulse ON time
                            wr-off       : Write pulse OFF time
                            rd-on        : Read pulse ON time
                            rd-off       : Read pulse OFF time
                            chip-delay   : Page read time [us]

  - st,nand-timing-relax : [Optional] Number of IP clock cycles by which to
                          "relax" timing configuration.  Required on some boards
                          to accommodate board-level limitations. Applies to
                          'st,nand-timing-spec' and ONFI timing mode
                          configuration.

  - nand-on-flash-bbt   : [Optional] Generic NAND properties (See mtd/nand.txt
  - nand-no-autoinc     :   for more details).

  - partitions          : [Optional] Subnode describing MTD partition map
                          (see mtd/partition.txt for more details).

Note, during initialisation, the NAND Controller timing registers are configured
according to one of the following methods, in order of precedence:

           1. Configuration based on "st,nand_timing_spec" if supplied.

           2. Configuration based on "st,nand_timing_data" if supplied.  Not
              supported by the stm-nand-bch driver, and deprecated in favour of
              method 1.

           3. Configuration based on ONFI timing mode, as advertised by the
              device during ONFI-probing (ONFI-compliant NAND only).

           4. Use reset/safe timing values

Example 'stm-nand-afm' configuration:

	nandafm: nand-afm{
		#interrupt-cells = <3>;
		#address-cells = <1>;
		#size-cells = <1>;
		interrupt-parent = <&intc>;
		compatible	= "st,nand-afm", "simple-bus";
		reg =	<0xFE901000 0x1000>;
		reg-names = "nand_mem";
		interrupts = <0 146 0x0>;
		interrupt-names = "nand_irq";
		status = "disabled";
		st,nand-banks = <&nand_banks>;
	};

	nand_banks: nand-banks {
		bank0 {
			/* NAND_BBT_USE_FLASH */
			nand-on-flash-bbt;
			nand-no-autoincr;
			st,nand-csn		= <0>;
			st,nand-timing-data	= <&nand_timing0>;
			partitions {
				#address-cells = <1>;
				#size-cells = <1>;
				partition@0{
					label = "NAND Flash 1";
					reg = <0x00000000 0x00800000>;
				};
				partition@800000{
					label = "NAND Flash 2";
					reg = <0x00800000 0x0F800000>;
				};
			};
		};
	};

	nand_timing0: nand-timing {
		sig-setup	= <10>;
		sig-hold	= <10>;
		CE-deassert	= <0>;
		WE-to-RBn	= <100>;
		wr-on		= <10>;
		wr-off		= <30>;
		rd-on		= <10>;
		rd-off		= <30>;
		chip-delay	= <30>;		/* delay in us */
	};
```

## Documentation/devicetree/bindings/mtd/stm-spi-fsm.txt
```
===============================================================================
                STM Serial Flash FSM Driver
===============================================================================

Required properties:

  - compatible          : Should be "st,spi-fsm"

  - reg                 : Standard named resource (see resource-names.txt for
  - reg-names           :   further details)
  - interrupts          :
  - interrupt-names     :

  - boot-device         : STM sysconf register the boot-device mode pins (see
                          stm/sysconf.txt)
  - boot-device-spi     : boot-device encoding for boot-from-spi

  - padcfg              : STM pad configuration (see stm/pad.txt)

  - caps-handle         : Subnode describing capabilites:
                            Board/Soc/IP capabilities
                              dual-mode           : DUAL mode
                              quad-mode           : QUAD mode

                            Board capabilities
                              reset-signal        : SoC reset routed to device
                                                      reset pin
                              reset-por           : SoC reset forces device POR
                                                      (e.g. on-board controller)

                            IP capabilities
                              addr-32bit          : 32bit addressing supported
                              no-poll-mode-change : Polling MODE-CHANGE broken
                              no-clk-div-4        : Bug prevents ClK-DIV=4
                              no-sw-reset         : S/W reset not possible
                              dummy-on-write      : WRITE requires "dummy" seq
                              no-read-repeat      : READ repeat sequence broken
                              no-write-repeat     : WRITE repeat sequence broken
                              no_read-status      : READ_STA broken.
                              read-status_clkdiv4 : READ_STA only at clk_div=4

Optional properties:
  - flash-name          : Name of Serial Flash device, used to confirm table
                          entry against JEDEC ID
  - max-freq            : Limit the max operating frequency of the SPI FSM
                          Controller
  - partitions          : Subnode describing MTD partition map (see
                          mtd/partition.txt for more details).

Example :
		spifsm:	fsm-spi{
			#stm-pad-cells = <1>;
			compatible	= "st,spi-fsm", "simple-bus";
			status		= "disabled";
			reg =	<0xfe902000 0x1000>;
			reg-names = "spi-fsm";
			padcfg-0 = <&padcfg_fsm>;
			boot-device	= <&sysconf 2598 0 4>;
			boot-device-spi	= <0x1a>;
			caps-handle = <&fsm_caps>;

			fsm_caps: fsm-caps {
				no-read-repeat;
				no-write-repeat;
				read-status-bug;
				dual-mode;
				quad-mode;
			};
		};
```

## Documentation/devicetree/bindings/net/isve.txt
```
* Integrated SoC Virtual Ethernet driver

Required properties:
- compatible: Should be "st,isve"
- reg: Address and length of the downstream and upstream register set
- interrupts: Should contain downstream and upstream interrupts
- interrupt-names: Should contain the interrupt names "isveirq_ds", "isveirq_us"
		   so the downstream and upstream interrupt names.

Optional properties:
isve,downstream_queue_size	Downstream queue size
isve,upstream_queue_size	Upstream queue size
isve,queue_number		Number of the queue
isve,skip_hdr			Extra bytes to remove (also in case of the
				HW is programmed to remove both extra and docsis
				headers from the incoming frames) to keep the
				Ethernet frame aligned to 32bit.
isve,hw_rem_hdr			This can be 1 to remove the docsis header,
				2 to remove the extra header and 3 to remove
				all the headers.
isve,ifname			This is to override the default interface name
				for example if17, if18, if19 and if1 commonly
				used on our SoCs for eCM etc.

Examples:
	if17:isve_queue_3 {
			compatible	= "st,isve", "simple-bus";
			status = "disabled";
			device_type = "network";
			reg = <0xfee2e460 0x20>, <0xfee1a478 0x20>;
			interrupts = <0 78 0>, <0 89 0>;
			interrupt-names = "isveirq_ds", "isveirq_us";

			isve,downstream_queue_size = <32>;
			isve,upstream_queue_size = <32>;
			isve,queue_number = <3>;
			isve,skip_hdr = <0x2>; /* two extra bytes have to be removed */
			isve,hw_rem_hdr = <0x3>; /* remove docsis and extra HDR */
			isve,ifname = "if17";
		};
```

## Documentation/devicetree/bindings/net/stmfp.txt
```
* STMicroelectronics 100/1000 Fastpath Ethernet driver (STMFP)

Required properties:
- compatible: Should be "st,fplite"
- reg: Address and length of the register set for the device
- interrupts: Should contain the STMFP interrupts
- interrupt-names: Should contain the interrupt names "fptxdmairq"
  "fprxdmairq" if this interrupt is supported in the "interrupts"
  property
- st,fp_clk_rate : fastpath clock rate (MHz)

- fpdocsis : DOCSIS interface specific platform info (Interface node)
- fpgige0 : FPGIGE0 interface specific platform info (Interface node)
- fpgige1 : FPGIGE1 interface specific platform info (Interface node)



Interface node(fpdocsis,fpgige0,fpgige1) specific Optional properties:
- st,phy-bus-name : Name of the mdio bus to connect.
- st,phy-bus-id : Mdio bus number to connect.
- st,phy-addr : phy address to connect to.

Examples:
		stmfp:ethernet@fee80000 {
			compatible	= "st,fplite";
			status = "disabled";
			device_type = "network";

			reg = <0xfee80000 0x40000>;
			interrupts = <0 101 0>, <0 102 0>;
			interrupt-names = "fptxdmairq", "fprxdmairq";
			st,fp_clk_rate = <200>;

			fpdocsis {
				status = "disabled";
			};

			fpgige0 {
				status = "disabled";
			};
			fpgige1 {
				status = "disabled";
			};
		};
```
