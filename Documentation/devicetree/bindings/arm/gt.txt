## Documentation/devicetree/bindings/net/stmmac.txt
```
* STMicroelectronics 10/100/1000 Ethernet driver (GMAC)

Required properties:
- compatible: Should be "snps,dwmac" or "st,spear600-gmac"
- reg: Address and length of the register set for the device
- interrupt-parent: Should be the phandle for the interrupt controller
  that services interrupts for this device
- interrupts: Should contain the STMMAC interrupts
- interrupt-names: Should contain the interrupt names "macirq"
  "eth_wake_irq" if this interrupt is supported in the "interrupts"
  property
- phy-mode: String, operation mode of the PHY interface.
  Supported values are: "mii", "rmii", "gmii", "rgmii".

Optional properties:
- mac-address		6 bytes, mac address
- phy-handle		Should be a phandle to the PHY.
- snps,clk-csr		Fixed CSR Clock range selection.
- snps,enh-desc		Boolean flag to indicate if mac support
			enhanced descriptors.
- snps,tx-coe		flag for Tx Checksum Offload engine presence
- snps,rx-coe		flag fo Rx Checksum Offload engine presence.
- snps,bugged-jumbo	some HWs are not able to perform the csum in HW for
			over-sized frames due to limited buffer sizes.
			Setting this flag the csum will be done in SW on
			JUMBO frames.
- snps,force-sf-dma-mode  force DMA to use the Store and Forward mode
			instead of the Threshold.
- snps,pbl		Programmable Burst Length
- snps,fixed-burst	Program the DMA to use the fixed burst mode
- snps,burst-len		This is the value we put in the register
			supported values are provided as macros in
			linux/stmmac.h header file.
- snps,phy-bus-name	Name of the mdio bus to connect. if not specified
			mac attempts to connect to stmmac mdio bus.
- snps,phy-bus-id	Mdio bus number to connect. if not specified 0 is used.
- snps,phy-addr		phy address to connect to.

- snps,reset-gpio 	gpio number for phy reset.
- snps,reset-active-low boolean flag to indicate if phy reset is active low.
- snps,reset-delays-us  is triplet of delays
	The 1st cell is reset pre-delay in micro seconds.
	The 2nd cell is reset pulse in micro seconds.
	The 3rd cell is reset post-delay in micro seconds.
- snps,bugged_sg	do not allow SG feature due to HW limits, e.g. bugged
			csum on fragments.
- snps,fixed-burst	Program the DMA to use the fixed burst mode
- snps,mixed-burst	Program the DMA to use the mixed burst mode
- snps,force_thresh_dma_mode	Force DMA to use the threshold mode for
				both tx and rx
- snps,force_sf_dma_mode	Force DMA to use the Store and Forward
				mode for both tx and rx. This flag is
				ignored if force_thresh_dma_mode is set.

Optional properties:
- mac-address: 6 bytes, mac address
>>>>>>> e2a240c... driver:net:stmmac: Disable DMA store and forward mode if platform data force_thresh_dma_mode is set.

Examples:

	gmac0: ethernet@e0800000 {
		compatible = "snps,dwmac";
		reg = <0xe0800000 0x8000>;
		interrupt-parent = <&vic1>;
		interrupts = <24 23>;
		interrupt-names = "macirq", "eth_wake_irq";
		mac-address = [000000000000]; /* Filled in by U-Boot */
		phy-mode = "gmii";

		snps,clk-csr	= <0x0>;
		snps,enh-desc;
		snps,tx-coe;
		snps,rx-coe;
		snps,bugged-jumbo;
		snps,force-sf-dma-mode;
		snps,pbl	= <32>;
		snps,burst-len	= <32>;
		snps,fixed-burst;

		/* PHY specific */
		snps,phy-bus-name = "stmmac";
		snps,phy-bus-id = <0>;
		snps,phy-addr = <0x9>;

		snps,reset-gpio = <&gpio_bank4 7>;
		snps,reset-active-low;
		snps,reset-delays-us = <0 10000 10000>;
	};
```

## Documentation/devicetree/bindings/pio-control.txt
```
===============================================================================
			pio-control
===============================================================================

Required properties:
- compatible		: not necessary as these properties are parsed at early init level.
- #retime-delay-cells	: Should be number of possible retime delays.
- retime-in-delay	: Should be array of delays in nsecs.
- retime-out-delay	: Should be array of delays in nsecs.
- retime-offset		: phandle to retime offsets in retime registers.
			These might not be necessary for dedicated retime registers.
	- clk1notclk0	: Should define offset for clk1not clk0 in retime register.
	- delay-lsb	: Should define offset for delay-lsb in retime register.
	- delay-msb	: Should define offset for delay msb in retime register.
	- invertclk	: Should define offset for invertclk in retime register.
	- retime	: Should define offset for retime in retime register.
	- clknotdata	: Should define offset for clknotdata in retime register.
	- double_edge	: Should define offset for double edge in retime register.
- alt-control		: Should be sysconf to control alternate function on pio.
- oe-control		: Should be sysconf to control Output enable on pio.
- pu-control		: Should be sysconf to control pull up on pio.
- od-control		: Should be sysconf to control open drain on pio.
- retime-style		: Should indicate which type of retime is used.
			possible values are "none", "packed" and "dedicated".
- retime-pin-mask	: Should be mask to specify which pins can be retimed.
- retime-control0	: Depending on retime-style the number of retime-controls vary.
			incase of packed its 2 and in case of dedicated its 8.
			This property points to sysconf which controls retime.


Example:

	pio_retime_offset: pio-retime-offset {
		clk1notclk0	= <0>;
		delay-lsb	= <2>;
		delay-msb	= <3>;
		invertclk	= <4>;
		retime		= <5>;
		clknotdata	= <6>;
		double_edge	= <7>;
	};

	pio-controls {
		#retime-delay-cells = <4>;
		retime-offset = <&pio_retime_offset>;
		retime-in-delay = <0 500 1000 1500>;
		retime-out-delay = <0 1000 2000 3000>;

		pio-control@0 {
			alt-control = <&stih415_sysconf 0 0 31>;
			oe-control = <&stih415_sysconf 5  0 7>;
			pu-control = <&stih415_sysconf 7  0 7>;
			od-control = <&stih415_sysconf 9  0 7>;
			retime-style = "packed";
			retime-pin-mask = <0xff>;
			retime-control0 = <&stih415_sysconf 16 0 31>;
			retime-control1 = <&stih415_sysconf 17 0 31>;
		};
		pio-control@1{
			alt-control = <&stih415_sysconf 1 0 31>;
			oe-control = <&stih415_sysconf 5  8 15>;
			pu-control = <&stih415_sysconf 7  8 15>;
			od-control = <&stih415_sysconf 9  8 15>;
			retime-style = "packed";
			retime-pin-mask = <0xff>;
			retime-control0 = <&stih415_sysconf 18 0 31>;
			retime-control1 = <&stih415_sysconf 19 0 31>;
		};
		...
	};
```

## Documentation/devicetree/bindings/rtc/rtc-stm-lpc.txt
```
 ST RTC
~~~~~~~~~~~~~~~~~~~~~~~~~~~~~~~~~~

Required properties:
  - compatible : Should be "st,rtc"
  - reg, reg-names, interrupts, interrupt-names : Standard way to define device
			resources with names. look in
			Documentation/devicetree/bindings/resource-names.txt

Optional properties:
  - no-hw-req		iomen in sys/serv 5197
  - need-wdt-reset	Workaround on 7141
  - clk-id		clk id for rtc.
  - clk-rate		clk rate to set.
  - irq-edge-rising	if irq type is raising edge
  - irq-edge-falling	if irq type is falling edge

Example:

	rtc@0 {
		#interrupt-cells = <3>;
		#address-cells = <1>;
        #size-cells = <1>;
		interrupt-parent = <&intc>;
	    compatible = "st,rtc";
	    interrupts = <0 118 0>;
	    reg = <0xfde05000 0x1000>;
		need-wdt-reset;
		irq-edge-rising;
	 };
```

## Documentation/devicetree/bindings/spi/spi_stm.txt
```
===============================================================================
				stm spi
===============================================================================

Required properties:

  - compatible		: "st,spi".

  - reg, reg-names, interrupts, interrupt-names
			: Standard way to define device resources with names
                          (see bindings/resource-names.txt)

  - padcfg-0		: Standard way to pass pad config to the drivers.

Optional properties:

  - st,dev-clk		: Specify device clk or alias clk.

  - cs-gpios		: List of GPIO chip selects (see
                          bindings/spi/spi-bus.txt)

Child nodes represent devices on the SPI bus.  See (see
bindings/spi/spi-bus.txt) for supported options.

Example:

	spi0: spi-stm3{
		compatible	= "st,spi",
		reg		= <0xfed43000 0x110>;
		interrupts	= <0 190 0>;
		status = "disabled";
		padcfg-0 = <&ssc0_pad_config>;

		cs-gpios	 = <&PIO13 3 0>,
				   <&PIO13 4 0>;

		#address-cells = <1>;
		#size-cells = <0>;

		m25p80@0 {
			#address-cells = <1>;
			#size-cells = <1>;
			compatible = "n25q128";
			spi-max-frequency = <1000000>;
			reg = <0>;

			partition@0 {
				label = "Serial Flash 1";
				reg = <0x00000000 0x00500000>;
			};
			partition@1{
				label = "Serial Flash 2";
				reg = <0x00500000 0x00b00000>;
			};
		 };

		spidev@1 {
			 compatible		= "spidev";
			 spi-max-frequency	= <1000000>;
			 reg			= <1>;
		 };


	};
```
