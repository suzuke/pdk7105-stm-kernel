## Documentation/devicetree/bindings/stm/stm-amba.txt
```
* stm amba bus config

Required properties:
- compatible : "amba-brige".
- reg, reg-names, interrupts, interrupt-names	: Standard way to define device resources with names.
look in Documentation/devicetree/bindings/resource-names.txt

- reg-offset	Offset in IP mem base for ahb-bridge registers.

- bridge_type2	Bridge type New generation.
			else
			Bridge type Older version ADCS: 7526996 is selected

Type of transaction to generate on stbus side
- max_opcode_LD4_ST4
- max_opcode_LD8_ST8
- max_opcode_LD16_ST16
- max_opcode_LD32_ST32
- max_opcode_LD54_ST64

- chunks_in_msg	integer value Defines the maximum number of chunk an STBus
			message may be built of at any time stbus message.
- packets_in_chunk	integer value Defines the maximum number of chunk an STBus
			message may be built of at any time.

- write_posting	to enable write-posting.

Fields unique to v1
- req_timeout

Fields unique to v2
- sd_config_missing	some of the bridges do not have sd_config register.

- threshold		integer value specifies the minimum number of data bytes to be stored
			at consecutive addresses which must be available in the
			Request FIFO in order to start issuing an STBus burst.

- req_notify_cell_based	Specifies when an AHB transaction is to be started.
				(cell-based): The transaction is started as soon as one
				STBus cell is received
				if property is not specified it selects
				(burst-based): The transaction is started as soon as an
				AHB burst is ready in the Request FIFOs

- complete_on_error		Specifies what the behaviour the bridge has to be when an
				error response is encountered on the AHB side.
				The current transaction is carried on to its completion
				if property not specified, The current transaction is aborted.

- merge_msg			message merge feature enable/disable.

- cell_based_trigger	Specifies whether the generation of STBus transactions
				has to be cell-based.
				if the property is not specified, the trigger defaults to
				be threshold-based.


- read_ahead		read ahead feature enable/disable.

Example:

	ethernet-bus-config: stm-eth-amba-bridge {
		reg-offset		=	<0x1FFC>;
		bridge_type2;
		chunks_in_msg	=	<1>;
		packets_in_chunk	=	<2>;
		write_posting;
		max_opcode_LD64_ST64;
		threshold		=	<512>;
		sd_config_missing;
		read_ahead;
	};
```

## Documentation/devicetree/bindings/stm/stm-coproc-st200.txt
```
===============================================================================
			stm cprocessor st200
===============================================================================

Required properties:
- compatible : "st,coproc-st200"
- reg, reg-names, interrupts, interrupt-names	: Standard way to define device
			resources with names. look in
			Documentation/devicetree/bindings/resource-names.txt
- st,proc-name		Processor Name.
- st,boot-shift	boot shift in the sysconf.
- st,not-reset		Should it reset the processor or Not.

- st,dev-config	is the standard way to pass dev config to the drivers.


Example:

		st231@0{
			compatible	= "st,coproc-st200", "simple-bus";
			st,proc-name = "audio";
			st,boot-shift = <6>;
			st,not-reset;
			st,dev-configs = <&st231_0_dev_config>;

			st231_0_dev_config: dev-config-0 {
				#stm-sysconf-cells = <4>;
				sysconfs{
					BOOT_ADDR = <&mpe_sysconf 650 6 31>;
					RESET = <&mpe_sysconf 659 26  26>;
				};
			};
		};
```

## Documentation/devicetree/bindings/stm/stm-coproc-st40.txt
```
===============================================================================
			stm cprocessor st40
===============================================================================

Required properties:
- compatible : "st,coproc-st40"
- st,proc-name		Processor Name.
- st,dev-config	is the standard way to pass dev config to the drivers.


Example:

st40_0 :st40@0{
   compatible	= "st,coproc-st40", "simple-bus";
   st,proc-name = "st40";
   st,dev-configs = <&st40_dev_config>;

   st40_dev_config: dev-config {
	#stm-sysconf-cells = <4>;
	sysconfs{
		BOOT_ADDR	=	<&mpe_sysconf 648 1 28>;
		RESET		=	<&mpe_sysconf 644 2 2>;
		LMI_SYS_BASE	=	<&mpe_sysconf 629 0 3>;
		LMI0_NOT_LMI1	=	<&mpe_sysconf 629 4 4>;
		BART_LOCK_ENABLE=	<&mpe_sysconf 629 5 5>;
		MASK_RESET	=	<&mpe_sysconf 645 2 2>;
		SW_PWR_RESET_MASK =	<&mpe_sysconf 645 8 8>;
		BART_LOCK_ENABLE_STATUS	=	<&mpe_sysconf 662 5 5>;
		BART_LMI0_NOT_LMI1_SEL_STATUS	=	<&mpe_sysconf 662 4 4>;
		BART_LMI_OFFSET_BASEADDR_STATUS	=	<&mpe_sysconf 662 0 3>;
     };
   };
 };
};
```

## Documentation/devicetree/bindings/stm/stm-emi.txt
```
===============================================================================
			stm emi
===============================================================================

Required properties:
- compatible : "st,emi".
- reg, reg-names, interrupts, interrupt-names	: Standard way to define device
			resources with names. look in
			Documentation/devicetree/bindings/resource-names.txt
- st,device-onfig	is the standard way to pass device config to drivers.


Example:

	emi {
		#interrupt-cells = <3>;
        #address-cells = <1>;
        #size-cells = <1>;
		compatible	= "st,emi";
		reg		=	<0 0x10000000>,
					<0xfea30000 0x874>;
		reg-names = "emi memory", "emi4 config";
		device-config = <&emi_dev_config>;
		emi_dev_config: emi-dev-config {
			#stm-sysconf-cells = <4>;
			device-seqs = <&emi_dev_seqs>;
			sysconfs{
				EMI_PWR = <&sysconf 742 0 0>;
				EMI_ACK = <&sysconf 766 0 0>;
			};
		};
	};
```

## Documentation/devicetree/bindings/stm/stm-miphy.txt
```
===============================================================================
		* st,miphy-mp, st,miphy-dummy
===============================================================================

Required properties:
- compatible	Should be "st,miphy-mp"
- reg, reg-names, interrupts, interrupt-names	: Standard way to define device
			resources with names. look in
			Documentation/devicetree/bindings/resource-names.txt
- st,miphy-modes	specifies miphy mode to be configured for each miphy
			line values can be an array of strings with following
			values.

	"sata"		if SATA IP is connected.
	"pcie"		if PCIE IP is connected.
	"unused"	if driver should not configure this miphy lane.

- st,style		Style id of the miphy device. possible values are
	"MiPHYA40X"	if MiPHYA40x is used.
	"MiPHY3-65"	if MiPHY3.65 is used.
	"MiPHY-DUMMY"	if Dummy Miphy used.


- device-config		standard way to specify device config.

Example:

	miphy: miphy@fe804000 {
                #address-cells = <1>;
                #size-cells = <1>;
		compatible	= "st,miphy-mp", "simple-bus";
		reg		= <0xfe804000 0xff>;

		st,miphy-modes	= "sata", "pcie";
		st,style	= "MiPHY3-65";

		miphy_dev_config: miphy-dev-config {
			#stm-sysconf-cells = <4>;
			sysconfs {
				SATA0_SOFT_RESET =	<&stih415_sysconf 377 7  7>;
				SATA1_SOFT_RESET =	<&stih415_sysconf 377 3  3>;
				MIPHY0_SOFT_RESET =		<&stih415_sysconf 376 18 18>;
				MIPHY1_SOFT_RESET =		<&stih415_sysconf 376 19 19>;
				SELECT_SATA =		<&stih415_sysconf 333 1  1>;
				MIPHY_SELECT =		<&stih415_sysconf 335 0  0>;
				SATAPHY1_OSC_FORCE_EXT= <&stih415_sysconf 333 2  2>;
			};
		};
	};
```

## Documentation/devicetree/bindings/stm/stm-pad-sysconf.txt
```
*******************************************************************************
			STM Pio and Sysconfs
*******************************************************************************

Every PIO is represented with below parameters.

-GPIO Bank	Bank to which this PIO belongs.
	each bank in the soc specific device tree is represented as below
	example with lable. This lable "gpio_bank0" us used as phandle when
	refering to this bank.

		gpio_bank0: gpio-bank@febe0000 {
			#gpio-cells = <1>;
			compatible = "st,gpio";
			reg = <0xfebe0000 0x100>;
			bank-name = "PIO0";
		};


- compatible : Should be "st,gpio".
- reg, reg-names, interrupts, interrupt-names	: Standard way to define device
			resources with names. look in
			Documentation/devicetree/bindings/resource-names.txt
- bank-name	Should be the name of the bank, which is used in debugfs.

-Pin		Offset in the PIO bank.
-Mode		Pad configuration is selected from one of the below phandles.

	input		Means pin in is Input
	input_pu	Pin is Input Pull-Up
	out_pp		Pin is Output Push-pull
	bidir		Pin is Bidir or O/P with OD
	bidir_pu	Pin is Bidir with Pull-Up


-Alternate-Fun	This could range from 0 to x, Generally 0 means its an PIO,
		else its controlled by an IP.
		pad config can't have altfunction 0, as altfun0 means a pio
		mode which can be directly controlled by gpio i/f.
		possible altfunction phandles:
		-------
		phanlde
		-------
		altfun_1
		altfun_2
		altfun_3
		altfun_4
		altfun_5
		altfun_6
		altfun_7

-Retime-Config	Retiming Configuration for the pin.
		Possible retime configuration are:

		-------		-------------
		phandle		args
		-------		-------------
		ni_clk		<delay> <clk>
		ic_clk		<delay> <clk>
		bypass		<delay>
		de_io		<delay> <clk>
		se_iclk_io	<delay> <clk>
		se_niclk_io	<delay> <clk>


-Condition	is a reference to phandle which should have st,enable property
		to select this pin as part of pad-config
		hw_flow_ctrl: flow-ctrl{
			enable = <0>;
		};



Typical structure of pad look:

<&bank &pin &mode &altFun &retime &cond>

Supported configurations:


If Pin is non PIO mode, meaning not in altfunction 0 it can take up and of the below models.

Model-1:
	#stm-pad-cells = <5>;
	<&bank &pin &mode &altFun_x &retime <retime-args> >

	Example:
		CTS	= <&gpio_bank2 6 &input_pu &altfun_3 &se_niclk 0>;


Model-2:
	#stm-pad-cells = <6>;
	<&bank &pin &mode &altFun_x &retime <retime-args> &cond>

	Example:
		CTS	= <&gpio_bank2 6 &input_pu &altfun_3 &se_niclk 0 &hw_flow_ctrl>;

Model-3:
	#stm-pad-cells = <5>;
	<&bank &pin &mode &altFun_x &cond>

	Example:
		CTS	= <&gpio_bank2 6 &input_pu &altfun_3 &hw_flow_ctrl>;

Model-4:
	#stm-pad-cells = <4>;
	<&bank &pin &mode &altFun_x>

	Example:
		CTS	= <&gpio_bank2 6 &input_pu &altfun_3>;


For Dynamically updating a Pad config, a named entry should be used
Example:
	ext-clk {
		gpios {
			phyclk = <&dir_in &altfun_3>;
		};
		sysconfs {
			INT_NOEXT_PHYCLK = <0>;
		};
	};

each gpio can take all the variable parameters except the gpio number and conditional variable.
So it just takes direction, altfunc and retime configuration.
Typical examples are:
		CTS	= <&input_pu &altfun_3 &se_niclk 0>;
		CTS	= <&input_pu &altfun_3>;


*******************************************************************************
			Sysconf
*******************************************************************************
Each sysconf bank is represented in soc device trees at two places.
First on to define the sysconf itself.
		sysconf@febf0000{
			compatible= "st,sysconf", "simple-bus";
			reg = <0xfebf0000 0xe4>;
			group@0 {
				group = <0>;
				offset = <0>;
				start	= <0>;
				group-name = "SYSCFG_WEST";
			};
		};

Required properties:

- compatible : should be "st,sysconf".
- reg, reg-names, interrupts, interrupt-names	: Standard way to define device
			resources with names. look in
			Documentation/devicetree/bindings/resource-names.txt
- group		: Should be sysconf group number.
- offset	: Should be the offset in the current sysconf.
- start		: Should be the start sysconf number in the current bank.
- group-name	: Should be name of the sysconf, will be used in debugfs.


Second entry adds a reverse lookup table, this node is used as phandle when
refering to a sysconf.

	sysconf: sysconf{
		#sysconf-group-cells	= <3>;
		sysconf-groups = <0    56 0>,
				 <200 283 1>,
				 <400 430 2>,
				 <705 769 3>,
				 <800 813 4>,
				 <900 944 5>;

		sysconf-names  = "SYSCFG_WEST",
				 "SYSCFG_SOUTH",
				 "SYSCFG_NORTH",
				 "SYSCFG_CPU",
				 "SYSCFG_DDR",
				 "SYSCFG_HD";
	};

Typical usage example:
in pio-control:

		pio-control@0 {
			alt-control = <&sysconf 0 0 31>;
			oe-control = <&sysconf 10 0 7>;
			pu-control = <&sysconf 13 0 7>;
			od-control = <&sysconf 16 0 7>;
			retime-style = "none";

		};
or in device config

		sata1_dev_config: sata_dev_config-0 {
			#stm-sysconf-cells = <4>;
			device-seqs = <&sata1_dev_seqs>;
			sysconfs{
				SATA_SELECT	= <&sysconf 267 9 9>;
				SATA_USE_30MHZ	= <&sysconf 268 0 0>;
				AHCI_HOST_PWR =	<&sysconf 267 8 8>;
				AHCI_HOST_PWR_ACK = <&sysconf 281 5 5>;
			};
		};

Usage is verymuch inline with the oldway.
```

## Documentation/devicetree/bindings/stm/stm-pcie.txt
```
==============================================================================
				st,pcie
==============================================================================

Required properties:
- compatible : "st,pcie".
- reg, reg-names, interrupts, interrupt-names	: Standard way to define device
			resources with names. look in
			Documentation/devicetree/bindings/resource-names.txt

- st,pcie_window	pcie window start and size
- st,io-window		where IO address start and size
- st,mem-window	Main memory physical start and size
- st,reset-pio		Which PIO the PERST# signal is on.
- st,ahb-fixup		Magic number to shove into the amba bus bridge.
- st,miphy-num		Which miphy this pcie is using

Example:

	pcie0: pcie@fe800000{
		#interrupt-cells = <3>;
                #address-cells = <1>;
                #size-cells = <1>;
		interrupt-parent = <&intc>;
		compatible	= "st,pcie", "simple-bus";
		reg		= <0xfe800000 0x1000>,
				 <0xfe808000 0x8>, <0x3FFF0000 0x10000>;
		reg-names	= "pcie cntrl", "pcie ahb","pcie config";

		interrupts	=  <0 166 0>, <0 171 0>, <0 167 0>;
		interrupt-names = "pcie inta", "pcie syserr", "msi mux";
		device-config = <&pcie_dev_config>;
		st,pcie_window = <0x20000000  0x1FFF0000>;
		st,mem-window	= <0x40000000  0x80000000>;

		st,reset-gpio = <&gpio_bank25 5>;
		st,ahb-fixup	= <0x264207>;
		st,miphy-num	= <1>;
	};


	pcie_dev_config: pcie-dev-config {
		#stm-sysconf-cells = <4>;
		sysconfs {
			PCIE_SOFT_RST	=	<&stih415_sysconf 377 34 34>;
			PCIE_SYS_INT	=	<&stih415_sysconf 334 5 5>;
			PCIE_P1_SSC_EN	=	<&stih415_sysconf 334 4 4>;
			PCIE_APP_REQ_RETRY_EN	= <&stih415_sysconf 334 3 3>;
			PCIE_APP_LTSSM_ENABLE	= <&stih415_sysconf 334 2 2>;
			PCIE_APP_INIT_RST =	<&stih415_sysconf 334 1 1>;
			PCIE_DEVICE_TYPE =	<&stih415_sysconf 334 0 0>;
		};
	};
```
